// Расписание пробуждений — настоящий main/bench_screens.cpp, собранный на этой машине.
//
// Зачем это есть. bench_screens.cpp — единственный крупный файл прошивки, которого не касался ни
// один тест: сон, радио, шину I2C и панель заменить нечем, кроме прибора. Но РЕШЕНИЕ отделимо от
// исполнения: что прибор собирался измерить, когда собирался выйти в сеть, будет ли кадр полным, на
// какой срок он собирался уснуть — всё это чистая арифметика над настройками, часами и состоянием
// RTC. Её и проверяем; сон по-прежнему проверяется на приборе.
//
// Чего тут НЕТ и не будет: «прибор действительно проснулся», «панель действительно нарисовала»,
// «радио действительно подключилось». Оснастка отвечает на вопрос «что прошивка решила», а не «что
// получилось». Второй вопрос — прогон на железе.
//
// Ни одна строка прошивки для этого не менялась. Тест включает .cpp целиком, потому что Plan, Tick и
// сами функции файловые, а часы перехвачены в host.cpp — тот же приём, что -Dprivate=public в
// tools/screenhost.
//
// Почти каждая проверка ниже привязана к дефекту, который уже случался: даты в комментариях — из
// журнала CLAUDE.md. Проверка, под которой нет такой истории, стоит дешевле.
//
// ОДНО ОГРАНИЧЕНИЕ, названное здесь, чтобы будущая проверка на нём не обманулась. На приборе
// каждое пробуждение — новая загрузка, и функциональные статики начинаются заново. Здесь все случаи
// идут в ОДНОМ процессе, поэтому статика переживает fresh(). В функциях под проверкой такая одна —
// `static bool asked` в plan_tick(), она один раз за загрузку зовёт ClockSync::forceClockSync().
// Значит на приборе её зовёт каждое пробуждение с подозрительными часами, а здесь — только первое.
// Ни одна проверка ниже на неё не опирается, и опираться не должна: это единственное место, где
// оснастка и прибор расходятся по построению, а не по настройке.
#include "stubs/idf/host.h"
#include "check.h"
#include "../main/bench_screens.cpp"
#include "../main/curve_log.h"
#include "../main/curve_summary.h"
#include "../main/curve_screen.h"
#include "../main/power_estimate.h"
#include "../main/power_history.h"
#include "../main/battery_display.h"
#include "esp_partition.h"

#include <cstdio>

// ------------------------------------------------------------------------------------------------
// Прибор в известном состоянии: заглушки сброшены, RTC чист, настроек нет.
//
// Переменные RTC перечислены поимённо, а не затёрты одним memset: на приборе они переживают сон, и
// «чистый RTC» здесь означает «первая загрузка после потери питания», а не «всё нули потому что так
// проще». Забытая переменная утечёт из случая в случай — это и была бы ложная зелень.
static void fresh(void)
{
    Host::reset();
    // Прошивка делает это в начале каждой загрузки, и без этого NVSManager возвращает умолчания на
    // ВСЁ: `if (!initialized) return false` — то есть ни одна настройка теста не была бы видна.
    NVSManager::getInstance().init();
    rtc_magic = 0; rtc_tick = 0;
    rtc_last_meas = 0; rtc_last_co2 = 0;
    rtc_was_night = false; rtc_night_began = 0;
    rtc_panel_powered = true;            // питание панели есть: прибор только что рисовал
    rtc_prev_valid = false;
    rtc_partials = 0; rtc_last_full = 0;
    rtc_blind_wakes = 0;
    rtc_lat_clock_ms = 0; rtc_lat_meas_ms = 0; rtc_sync_trim_ms = 0;
    rtc_lockout = false; rtc_lock_drawn = false; rtc_volt = 0.0f;
    // «Первая загрузка после потери питания» — и для батареи тоже: якорь потолка заряда и показанный
    // процент живут в RTC_NOINIT, и на приборе их в этом случае сбрасывает forget_previous_build().
    // Без этой строки показанный процент одного случая утекал бы в следующий: он никогда не растёт.
    BatteryMonitor::getInstance().forgetChargeAnchor();
}

// Местное время суток в отметку UTC, при заданном поясе. Собственная арифметика, а не mktime():
// хост-пояс этой машины не должен влиять ни на один случай.
static time_t at_local(int h, int m, float tz_h = 0.0f)
{
    const time_t midnight = 1758672000;              // 2025-09-24 00:00:00 UTC, просто известная точка
    return midnight + h * 3600 + m * 60 - (time_t)(tz_h * 3600);
}

static ButtonWake no_press(void) { ButtonWake b{}; return b; }
static ButtonWake press(bool lng = false) { ButtonWake b{}; b.by_button = true; b.btn_long = lng; return b; }

int main(void)
{
    // --------------------------------------------------------------------------------------------
    // --------------------------------------------------------------------------------------------
    // Сколько РЕАЛЬНО проходит между замерами CO2 — прогоном, а не чтением условия. Профиль обещает
    // владельцу минуты; проверять надо расстояние между замерами, потому что оно складывается из
    // трёх мест сразу: порога в plan_tick(), отметки rtc_last_co2 и длины сна.
    //
    // Повод — прибор владельца 2026-09-30: Performance обещает 5 минут, а мерил раз в 10.
    //
    // Прогон честный: настоящие plan_tick() и time_to_next_wake(), отметки ставятся так же, как их
    // ставит measure() (`rtc_last_co2 = now` при want_co2), и время двигается ровно на тот сон,
    // который прошивка попросила.
    //
    // ВАЖНО, и это моя ошибка от того же дня: первая редакция гоняла plan_tick() и штамповала
    // rtc_last_co2 сама, по t.do_co2. Она показала ровные 5 минут — и была ложной зеленью, потому
    // что мерила РАСПИСАНИЕ, а не прибор: штамп ставит measure(), а её вызывающий гейтит на
    // do_meas. Теперь гоняется настоящий run_working_cycle(): он [[noreturn]] и кончается броском
    // HostDeepSleep, то есть одно пробуждение = один вызов, а длину сна выбирает сама прошивка.
    auto co2_gap_minutes = [](int hours) {
        int    prev = 0, n = 0;
        double sum = 0;
        for (int64_t end = Host::wall + hours * 3600; Host::wall < end; ) {
            Tick t = plan_tick(no_press());
            // Гейт из run_working_cycle(), дословно. Он здесь ПОВТОРЁН, и это named-ограничение:
            // гонять настоящий цикл нельзя, пока стенд не отвечает за SCD41, а без ответа датчика
            // rtc_last_co2 не штампуется вовсе. Поэтому t_console сверяет эту строку с прошивкой —
            // без сверки копия разошлась бы молча, а первая редакция этого прогона именно так и
            // дала ложные 5 минут: она штамповала по do_co2, которого в гейте не было.
            if (t.do_meas || t.do_co2 || t.forced) {
                if (t.do_meas) rtc_last_meas = t.now;              // measure(): if (do_meas)
                if (t.do_co2 || t.forced) {                        // measure(): if (want_co2 && co2_ok)
                    if (prev) { sum += (double)(t.now - prev); n++; }
                    prev = (int)t.now;
                    rtc_last_co2 = t.now;
                }
            }
            rtc_tick = rtc_tick + 1;
            const NextWake nx = time_to_next_wake(t, false, t.plan.live_clock, 0, 0);
            Host::advance(nx.s ? nx.s : 60);
        }
        return n ? sum / n / 60.0 : 0.0;
    };

    area("замеры CO2: расстояние между ними, а не условие");
    {
        // Performance с живыми часами — 5 минут, как и обещано карточкой.
        fresh(); Host::wall = at_local(12, 0); Host::mono_us = 1000000;
        Host::set_u8("profile", 0); Host::set_u8("live_clk", 1);
        near(co2_gap_minutes(3), 5.0, 0.5, "Performance, живые часы: минут между замерами CO2");
    }
    {
        // ТО ЖЕ САМОЕ с выключенными живыми часами. Владелец не менял профиль — он выключен
        // отдельным переключателем (общим с 2026-09-21), и карточка по-прежнему обещает 5 минут.
        fresh(); Host::wall = at_local(12, 0); Host::mono_us = 1000000;
        Host::set_u8("profile", 0); Host::set_u8("live_clk", 0);
        near(co2_gap_minutes(3), 5.0, 0.5,
             "Performance без живых часов: минут между замерами (карточка обещает 5)");
    }
    {
        fresh(); Host::wall = at_local(12, 0); Host::mono_us = 1000000;
        Host::set_u8("profile", 1); Host::set_u8("live_clk", 0);
        near(co2_gap_minutes(4), 15.0, 1.5, "Optimal без живых часов: минут между замерами");
    }
    {
        // Ночью интервал удваивается намеренно — это настройка, а не дефект.
        fresh(); Host::wall = at_local(1, 0); Host::mono_us = 1000000;
        Host::set_u8("profile", 0); Host::set_u8("live_clk", 1);
        near(co2_gap_minutes(3), 10.0, 1.0, "Performance ночью: удвоение намеренное, минут");
    }

    area("NTP: отступать всё дальше, а не ломиться каждые шесть часов");
    {
        // Повод: неудачная попытка стоит до 30 с радио (бюджет повтора lwIP), а пауза была плоской
        // навсегда. На сети, которая глушит UDP/123, это ~3 мА*ч в сутки при измеренном бюджете
        // 13,66 — радио удваивается молча, потому что часы-то идут. Тот же класс, что плоский
        // повтор подключения Wi-Fi, из-за которого выключенный на выходные роутер сажал ячейку.
        //
        // Проверяется АРИФМЕТИКА, и ради этого лестница вынесена в заголовок: у неё два потолка и
        // напрашивающаяся ошибка на единицу, а их структурной проверкой не поймать.
        const long H = 3600, M = 60;
        eq_int(ClockSync::retryAfter(true, 0), 6 * H,  "часы есть, отказов нет — 6 ч");
        eq_int(ClockSync::retryAfter(true, 1), 6 * H,  "первый отказ — те же 6 ч, а не сразу вдвое");
        eq_int(ClockSync::retryAfter(true, 2), 12 * H, "второй подряд — 12 ч");
        eq_int(ClockSync::retryAfter(true, 3), 24 * H, "третий — сутки");
        eq_int(ClockSync::retryAfter(true, 4), 24 * H, "дальше потолок: сутки");
        eq_int(ClockSync::retryAfter(true, 8), 24 * H, "и на восьмом тоже сутки, без переполнения");

        // Без часов прибор обязан продолжать спрашивать: лестница короче и ниже.
        eq_int(ClockSync::retryAfter(false, 0),  30 * M, "часов нет, отказов нет — 30 мин");
        eq_int(ClockSync::retryAfter(false, 1),  30 * M, "первый отказ — 30 мин");
        eq_int(ClockSync::retryAfter(false, 2),  60 * M, "второй — час");
        eq_int(ClockSync::retryAfter(false, 3), 120 * M, "третий — два часа");
        eq_int(ClockSync::retryAfter(false, 4), 240 * M, "четвёртый — четыре часа");
        eq_int(ClockSync::retryAfter(false, 9), 240 * M, "дальше потолок: четыре часа");

        // Два инварианта, которые переживут любую смену чисел: пауза не ноль (иначе попытка в
        // каждом окне) и не больше суток (иначе прибор с ушедшими часами чинится только руками).
        bool in_band = true, not_longer = true;
        for (unsigned f = 0; f <= 12; f++) {
            const long a = ClockSync::retryAfter(true, f), b = ClockSync::retryAfter(false, f);
            if (a < 30 * M || a > 24 * H || b < 30 * M || b > 24 * H) in_band = false;
            if (b > a) not_longer = false;
        }
        ok(in_band,    "при любом счётчике пауза от получаса до суток");
        ok(not_longer, "без часов прибор спрашивает не реже, чем с часами");
    }

    area("план: профили");
    {
        fresh();
        Plan p = readPlan(Host::wall);
        eq_int(p.profile, 1, "без настроек — Optimal");
        eq_int(p.meas_min, 15, "Optimal: CO2 раз в 15 мин");
        eq_int(p.radio_min, 30, "Optimal: радио раз в 30 мин");
        ok(p.live_clock, "Optimal: живые часы включены");
        ok(!p.offline && !p.no_net && !p.matter, "Optimal: сеть есть");
    }
    {
        fresh(); Host::set_u8("profile", 0);
        Plan p = readPlan(Host::wall);
        eq_int(p.meas_min, 5, "Performance: CO2 раз в 5 мин");
        eq_int(p.radio_min, 15, "Performance: радио раз в 15 мин");
    }
    {
        fresh(); Host::set_u8("profile", 2);
        Plan p = readPlan(Host::wall);
        eq_int(p.meas_min, 30, "Ultra Save: CO2 раз в 30 мин");
        eq_int(p.radio_min, 0, "Ultra Save: расписания радио нет");
        ok(!p.live_clock, "Ultra Save гасит живые часы");
        ok(p.offline, "Ultra Save: погоды не будет");
        ok(!p.no_net, "Ultra Save: сеть ЕСТЬ, просто не по расписанию — тревога её поднимет");
    }
    {
        // Значение вне диапазона может лежать в хранилище с прошлых сборок; оно превращается в
        // интервалы, то есть в то, как часто прибор тратит заряд.
        fresh(); Host::set_u8("profile", 7);
        eq_int(readPlan(Host::wall).profile, 1, "профиль вне диапазона — Optimal");
    }
    {
        fresh(); Host::set_u8("profile", 3);
        Plan p = readPlan(Host::wall);
        eq_int(p.meas_min, 15, "Custom без своих значений — как Optimal");
        eq_int(p.radio_min, 30, "то же для радио");
    }
    {
        fresh(); Host::set_u8("profile", 3);
        Host::set_u32("s_int", 7); Host::set_u32("w_int", 45);
        Plan p = readPlan(Host::wall);
        eq_int(p.meas_min, 7, "Custom: своё значение CO2 действует");
        eq_int(p.radio_min, 45, "Custom: своё значение радио действует");
    }

    // --------------------------------------------------------------------------------------------
    area("план: сеть");
    {
        // ЖУРНАЛ: «Это должно происходить ДО вывода radio_min, и не происходило». Интервал
        // обнулялся ПОСЛЕ, поэтому offline выходил верным, а radio_min оставался профильным — и
        // расписание читает именно radio_min. Прибор без сети продолжал планировать сессии и
        // ходить в сеть, имя которой осталось в NVS: самая долгоживущая конфигурация оказывалась
        // самой короткой.
        fresh(); Host::set_u8("no_wifi", 1);
        Plan p = readPlan(Host::wall);
        eq_int(p.radio_min, 0, "прибор без сети: радио выключено (не профильные 30)");
        ok(p.no_net,  "прибор без сети: отправлять некуда");
        ok(p.offline, "прибор без сети: погоды не будет");
    }
    {
        fresh(); Host::set_u8("wl_mode", 2);
        Plan p = readPlan(Host::wall);
        ok(p.matter, "wl_mode 2 — режим Matter");
        ok(p.no_net, "Matter: для расписания это прибор без сети");
        eq_int(p.radio_min, 0, "Matter: окна Wi-Fi по расписанию нет");
    }
    {
        // Хаб, которому сказали один раз и больше никогда, хуже отсутствия хаба: Home Assistant
        // навсегда показывает показание момента настройки и никак не сообщает, что оно умерло.
        fresh(); Host::set_u8("wl_mode", 1); Host::set_u8("profile", 3); Host::set_u32("w_int", 0);
        eq_int(readPlan(Host::wall).radio_min, 60, "режим хаба: у радио есть пол — раз в час");
    }
    {
        fresh(); Host::set_u8("wl_mode", 1); Host::set_u8("no_wifi", 1);
        Plan p = readPlan(Host::wall);
        eq_int(p.radio_min, 0, "хаб + прибор без сети: пол не воскрешает радио");
        ok(p.no_net, "и он остаётся без сети");
    }
    {
        // Значение могло попасть в хранилище до того, как его стали зажимать в /api/save, а
        // превращается оно прямо в то, как часто прибор выходит в эфир.
        fresh(); Host::set_u8("profile", 3); Host::set_u32("w_int", 1);
        eq_int(readPlan(Host::wall).radio_min, 5, "интервал радио зажат снизу пятью минутами");
    }
    {
        fresh(); Host::set_u8("profile", 3); Host::set_u32("s_int", 0);
        eq_int(readPlan(Host::wall).meas_min, 1, "интервал CO2 не может стать нулём");
    }

    // --------------------------------------------------------------------------------------------
    area("план: ночь");
    {
        // Окно 23 -> 7 переходит через полночь, то есть это не проверка диапазона.
        fresh();
        ok( readPlan(at_local(23, 30)).night, "23:30 — ночь");
        ok( readPlan(at_local( 6,  0)).night, "06:00 — ночь");
        ok(!readPlan(at_local(12,  0)).night, "полдень — не ночь");
        ok(!readPlan(at_local( 7,  0)).night, "07:00 — уже день (граница не включается)");
        ok( readPlan(at_local(23,  0)).night, "23:00 — уже ночь (граница включается)");
    }
    {
        fresh(); Host::set_u8("nm_sh", 8); Host::set_u8("nm_eh", 8);
        ok(!readPlan(at_local(8, 30)).night, "начало равно концу — ночи нет вовсе");
    }
    {
        fresh();
        Plan p = readPlan(at_local(2, 0));
        eq_int(p.meas_min, 30, "ночью интервал CO2 удвоен (15 -> 30)");
        eq_int(p.radio_min, 0, "ночью радио молчит в любом профиле");
        ok(!p.live_clock, "ночью живых часов нет — на экране луна");
    }
    {
        fresh(); Host::set_u32("s_int_n", 90);
        eq_int(readPlan(at_local(2, 0)).meas_min, 90, "своё ночное значение важнее удвоения");
    }
    {
        // РЕШЕНИЕ ПОЛЬЗОВАТЕЛЯ 2026-09-21: ночь перестала включаться в Ultra Save насильно.
        // Там она стоила 5 % и отнимала у владельца выбор.
        fresh(); Host::set_u8("profile", 2); Host::set_u8("nm_en", 0);
        ok(!readPlan(at_local(2, 0)).night, "Ultra Save больше не навязывает ночной режим");
    }
    {
        fresh(); Host::set_u8("nm_en", 0);
        ok(!readPlan(at_local(2, 0)).night, "выключенный ночной режим выключен");
    }
    {
        // Пояс двигает ОКНО, а не солнце: в UTC+2 местные два часа ночи — это полночь UTC.
        fresh(); Host::set_float("tz_h", 2.0f);
        ok( readPlan(at_local(2, 0, 2.0f)).night, "с поясом +2: местные 02:00 — ночь");
        ok(!readPlan(at_local(12, 0, 2.0f)).night, "с поясом +2: местный полдень — не ночь");
    }
    {
        // Часов нет — ночь определить нечем, и притворяться, что она есть, нельзя: это удвоило бы
        // интервал и погасило радио у прибора, который как раз и не смог достать время.
        fresh(); Host::wall = 0;
        ok(!readPlan(0).night, "без часов ночи нет");
    }

    // --------------------------------------------------------------------------------------------
    area("такт: ночная парковка");
    {
        fresh(); rtc_tick = 5; rtc_prev_valid = true; rtc_last_full = at_local(2, 0) - 100;
        Host::wall = at_local(2, 0);
        Tick t = plan_tick(no_press());
        ok(t.plan.night, "ночной тик");
        ok(t.night_park, "ночью сон может снять питание панели");
        ok(t.night_freeze, "и ЭТОТ тик рисует последний кадр — панель ещё под питанием");
        ok(t.due_full, "замораживающий кадр ОБЯЗАН быть полным: частичный не переживает снятия питания");
    }
    {
        // Нажатие — исключение: кто-то смотрит, значит кадр перерисовывается и питание остаётся.
        fresh(); rtc_tick = 5; rtc_prev_valid = true; Host::wall = at_local(2, 0);
        Tick t = plan_tick(press());
        ok(t.plan.night, "ночь");
        ok(!t.night_park, "нажатие отменяет ночную парковку");
        ok(!t.night_freeze, "и замораживать нечего");
    }
    {
        // Режиму Matter парковать негде: он не уходит в глубокий сон и не зовёт
        // sleep_after_cycle(). Оставь его внутри — получил бы ночной чистящий кадр без выигрыша.
        fresh(); rtc_tick = 5; rtc_prev_valid = true;
        Host::set_u8("wl_mode", 2); Host::wall = at_local(2, 0);
        Tick t = plan_tick(no_press());
        ok(t.plan.night && t.plan.matter, "ночь в режиме Matter");
        ok(!t.night_park, "Matter не паркует панель на ночь");
    }
    {
        // Второй и дальше ночные тики панель не трогают вовсе: питания уже нет.
        fresh(); rtc_tick = 5; rtc_prev_valid = false; rtc_panel_powered = false;
        Host::wall = at_local(3, 0);
        Tick t = plan_tick(no_press());
        ok(t.night_park, "по-прежнему ночь");
        ok(!t.night_freeze, "замораживает только ПЕРВЫЙ ночной тик, не каждый");
    }
    {
        // Прибор, закончивший настройку ночью, спал под логотипом с обесточенной панелью — флаг
        // сказал бы «уже заморожено», хотя ничего не заморожено.
        fresh(); rtc_tick = 0; rtc_panel_powered = false; Host::wall = at_local(2, 0);
        Tick t = plan_tick(no_press());
        ok(t.night_freeze, "первый тик ночью замораживает, даже если панель считалась обесточенной");
    }
    {
        fresh(); rtc_tick = 5; rtc_prev_valid = true; rtc_was_night = true;
        Host::wall = at_local(7, 30);
        Tick t = plan_tick(no_press());
        ok(!t.plan.night, "утро");
        ok(t.night_ended, "конец ночи распознан");
        ok(t.due_full, "утром чистящий кадр — за всю ночь");
        ok(Host::logged("night over"), "и это сказано в логе");
    }

    // --------------------------------------------------------------------------------------------
    area("такт: чистящий кадр");
    {
        // Число — решение пользователя (2026-09-30, час вместо трёх), и у него измеренная цена:
        // 24 чистящих кадра в сутки вместо 8, это 20 с панели, 0,22 мА·ч, 1,6 % бюджета.
        // Закрепляю и САМО значение, и связь между двумя ограничителями: комментарий объявляет,
        // что счётчик — запасной путь для прибора без часов и «выставлен под то же время», а
        // проверить это было нечем. Сменить одно, забыв другое, — ровно тот способ разъехаться.
        eq_int(FULL_EVERY_SEC, 3600, "чистящий кадр раз в час");
        eq_int(FULL_EVERY_PARTIALS, FULL_EVERY_SEC / 60,
               "счётчик частичных выставлен под тот же час при минутной каденции");
    }
    {
        fresh(); rtc_tick = 0;
        ok(plan_tick(no_press()).due_full, "первый тик — полный кадр");
    }
    {
        fresh(); rtc_tick = 5; rtc_prev_valid = false; rtc_last_full = Host::wall - 10;
        ok(plan_tick(no_press()).due_full, "опоры нет — кадр полный");
    }
    {
        fresh(); rtc_tick = 5; rtc_prev_valid = true;
        rtc_partials = FULL_EVERY_PARTIALS; rtc_last_full = Host::wall - 10;
        ok(plan_tick(no_press()).due_full, "набрав предел частичных — чистящий кадр");
    }
    {
        fresh(); rtc_tick = 5; rtc_prev_valid = true;
        rtc_partials = 3; rtc_last_full = Host::wall - FULL_EVERY_SEC;
        ok(plan_tick(no_press()).due_full, "по истечении срока — чистящий кадр");
    }
    {
        fresh(); rtc_tick = 5; rtc_prev_valid = true;
        rtc_partials = 3; rtc_last_full = Host::wall - 60;
        ok(!plan_tick(no_press()).due_full, "минуту назад рисовали полный — этот частичный");
    }

    // --------------------------------------------------------------------------------------------
    area("такт: замер");
    {
        fresh(); rtc_tick = 5; rtc_last_meas = Host::wall - 100; rtc_last_co2 = Host::wall - 100;
        Tick t = plan_tick(no_press());
        ok(!t.do_meas, "сто секунд назад мерили газ — ещё не срок");
        ok(!t.do_co2,  "и CO2 тоже");
    }
    {
        fresh(); rtc_tick = 5; rtc_last_meas = Host::wall - (GAS_SEC - GAS_EARLY_SEC);
        rtc_last_co2 = Host::wall - 10;
        ok(plan_tick(no_press()).do_meas, "газ считается подошедшим на 2 с раньше срока");
    }
    {
        // Окно маленькое НАМЕРЕННО: BSEC считает срок от момента вызова, поэтому тик на N с раньше
        // будет ждать next_call эти N с в каждом следующем периоде.
        fresh(); rtc_tick = 5; rtc_last_meas = Host::wall - (GAS_SEC - GAS_EARLY_SEC - 1);
        rtc_last_co2 = Host::wall - 10;
        ok(!plan_tick(no_press()).do_meas, "на 3 с раньше — ещё нет: окно ровно две секунды");
    }
    {
        fresh(); rtc_tick = 5; rtc_last_meas = Host::wall - 10;
        rtc_last_co2 = Host::wall - 15 * 60;
        ok(plan_tick(no_press()).do_co2, "интервал CO2 подошёл");
    }

    // --------------------------------------------------------------------------------------------
    area("такт: без часов");
    {
        // ЖУРНАЛ: «!clock_ok было УСЛОВИЕМ, поэтому прибор, не достающий NTP, делал ПОЛНЫЙ замер на
        // каждом 60-секундном пробуждении, навсегда. Пятикратная частота против профиля, и экран
        // тикал совершенно здоровым, пока ячейка пустела за недели.» Проверяется не флаг, а ЦЕНА:
        // сколько прибор спит.
        fresh(); Host::wall = 0; rtc_tick = 5;
        Tick t = plan_tick(no_press());
        ok(!t.clock_ok, "часов нет");
        ok(t.do_meas, "слепой прибор мерит на каждом пробуждении");
        NextWake n = time_to_next_wake(t, false, t.plan.live_clock);
        eq_int(n.s, GAS_SEC, "...и поэтому спит ГАЗОВЫЙ период, а не минуту");
    }
    {
        fresh(); Host::wall = 0; rtc_tick = 5; rtc_blind_wakes = 0;
        plan_tick(no_press());
        eq_int(rtc_blind_wakes, 1, "без часов каденция держится счётом пробуждений");
    }
    {
        fresh(); rtc_tick = 5; rtc_blind_wakes = 17;
        plan_tick(no_press());
        eq_int(rtc_blind_wakes, 0, "с часами счётчик слепых пробуждений обнуляется");
    }

    // --------------------------------------------------------------------------------------------
    area("сон: до границы минуты");
    {
        // Ровный сон на 60 с приклеил бы обновление к моменту пробуждения, и минута появлялась бы
        // на стекле в :00.6, потом :01.7, потом :02.9.
        fresh(); rtc_tick = 5; rtc_last_meas = Host::wall - 10; rtc_last_co2 = Host::wall - 10;
        Host::wall = at_local(12, 0) + 20;               // двадцать секунд после границы
        Host::mono_us = 0;
        Tick t = plan_tick(no_press());
        NextWake n = time_to_next_wake(t, false, true);
        ok(n.s > 0 && n.s < TICK_SEC, "сон меньше минуты — целимся в её границу");
        ok(n.s >= 30, "и это следующая граница, а не через полчаса");
    }
    {
        fresh(); rtc_tick = 5;
        Tick t = plan_tick(no_press());
        NextWake n = time_to_next_wake(t, false, false);   // живых часов на следующем тике не будет
        ok(n.s >= 5, "без живых часов сон не короче пяти секунд");
        ok(n.s <= GAS_SEC, "и не длиннее газового периода");
    }

    // --------------------------------------------------------------------------------------------
    area("опережение: чем НЕ кормить среднее");
    {
        // 0.10.11 добавил целый класс тиков, которые не рисуют вовсе: каждый ночной между
        // замороженным кадром и утром. Кормить ими среднее — тянуть его вниз на стоимость кадра, и
        // первые утренние тики садятся мимо минуты.
        // rtc_last_meas обязателен: без него do_meas истинно, тик считается замерочным, и функция
        // пишет в rtc_lat_meas_ms. Первая редакция этой проверки об этом не знала и проходила
        // потому, что менялось соседнее поле, — ровно та ложная зелень, которую тест должен ловить.
        fresh(); rtc_tick = 5; rtc_lat_clock_ms = 1200;
        rtc_last_meas = Host::wall - 10; rtc_last_co2 = Host::wall - 10;
        Tick t = plan_tick(no_press());
        ok(!t.do_meas, "тик не замерочный — среднее пойдёт в счётчик обычных тиков");
        Host::mono_us += 400000;                           // такт «занял» ещё 400 мс
        time_to_next_wake(t, false, true, 0, /*drew=*/0);
        eq_int(rtc_lat_clock_ms, 1200, "тик, не нарисовавший ничего, среднее не меняет");
    }
    {
        // Полный кадр вчетверо медленнее частичного; пустить его в среднее — испортить оценку на
        // следующую сотню тиков.
        fresh(); rtc_tick = 5; rtc_lat_clock_ms = 1200;
        rtc_last_meas = Host::wall - 10; rtc_last_co2 = Host::wall - 10;
        Tick t = plan_tick(no_press());
        Host::mono_us += 2000000;
        time_to_next_wake(t, /*full_now=*/true, true, 0, /*drew=*/2);
        eq_int(rtc_lat_clock_ms, 1200, "полный кадр на незамерочном тике среднее не меняет");
    }
    {
        fresh(); rtc_tick = 5; rtc_lat_clock_ms = 1200;
        rtc_last_meas = Host::wall - 10; rtc_last_co2 = Host::wall - 10;
        Tick t = plan_tick(no_press());
        const int64_t t0 = Host::mono_us;
        Host::mono_us += 800000;
        time_to_next_wake(t, false, true, t0, /*drew=*/1);
        ok(rtc_lat_clock_ms != 1200, "обычный тик с частичным кадром среднее ОБНОВЛЯЕТ");
        // Скользящее среднее с весом 3:1 — одно плохое измерение не должно уводить расписание.
        eq_int(rtc_lat_clock_ms, (1200 * 3 + 800) / 4, "и движется к измеренному на четверть пути");
    }

    // --------------------------------------------------------------------------------------------
    area("батарея: блокировка по разряду");
    {
        fresh(); Host::vcell = 3.10f;
        ok(battery_too_low(true), "3.10 В на батарее — блокировка");
        ok(rtc_lockout, "флаг выставлен");
    }
    {
        fresh(); Host::vcell = 3.10f; Host::usb_in = true;
        ok(!battery_too_low(true), "на кабеле распоряжается зарядник — блокировки нет");
    }
    {
        // ЖУРНАЛ 2026-09-18: кешированный путь не смотрел на кабель. Прибор, заблокированный и
        // затем воткнутый в зарядку, на каждом минутном тике отвечал «заблокирован», а
        // sleep_low_battery() вооружала «проснуться, когда вставят кабель» на УЖЕ вставленном
        // кабеле — и оно срабатывало мгновенно. Петля загрузка-сон-загрузка до пяти минут, на
        // почти севшей ячейке, без картинки и без объяснения.
        fresh(); rtc_lockout = true; rtc_volt = 3.10f; Host::usb_in = true;
        ok(!battery_too_low(false), "кешированный путь тоже снимает блокировку на кабеле");
        ok(!rtc_lockout, "и флаг снят, иначе следующий тик начнёт петлю заново");
    }
    {
        // Второй, независимый отказ: газомер умер, прибор уже заблокирован. Оба пути отказа раньше
        // возвращались ДО проверки кабеля, и прибор оставался заблокированным НАВСЕГДА — без
        // экрана, радио, консоли и кнопки. Выходом было только вынуть ячейку.
        fresh(); rtc_lockout = true; Host::gauge_ok = false; Host::bus_ok = false;
        Host::usb_in = true;
        ok(!battery_too_low(true), "газомер молчит, но кабель есть — блокировка снята");
        ok(Host::logged("charger"), "и причина названа в логе");
    }
    {
        fresh(); rtc_lockout = true; rtc_volt = 3.10f; Host::usb_in = false;
        ok(battery_too_low(false), "без кабеля кешированный путь блокировку держит");
    }
    {
        // Снятие требует запаса: ячейка под нагрузкой проседает, и дребезг у порога гонял бы прибор
        // между «работаю» и «лежу» на каждом тике.
        fresh(); rtc_lockout = true; rtc_volt = 3.10f; Host::vcell = 3.35f;
        ok(battery_too_low(true), "3.35 В мало, чтобы выйти из блокировки (нужно +0.15)");
        Host::vcell = 3.46f;
        ok(!battery_too_low(true), "3.46 В — можно продолжать");
    }
    {
        // Решение пользователя 2026-09-27: порог отключения вшит (battery_spec.h) и из хранилища
        // не читается вовсе. Это не косметика — без поля в консоли значение, записанное в обход,
        // нечем исправить, а порог 4.5 В защёлкивает блокировку на полной ячейке навсегда.
        // Проверяется поведением, а не текстом: хранилище говорит одно, прибор слушает константу.
        fresh(); Host::set_float("lowbat_v", 3.60f); Host::vcell = 3.45f;
        ok(!battery_too_low(true),
           "3.45 В выше вшитых 3.30 — записанный в NVS порог 3.60 игнорируется");
        fresh(); Host::set_float("lowbat_v", 3.00f); Host::vcell = 3.20f;
        ok(battery_too_low(true),
           "3.20 В ниже вшитых 3.30 — записанный в NVS порог 3.00 тоже игнорируется");
        fresh(); rtc_volt = 3.20f; Host::set_float("lowbat_v", 3.00f);
        ok(battery_too_low(false), "кешированный путь берёт ту же константу");
    }
    {
        // И само значение — то, что объявлено, а не совпавшее по случайности.
        fresh(); Host::vcell = BATTERY_CUTOFF_V + 0.01f;
        ok(!battery_too_low(true), "чуть выше вшитого порога — работаем");
        fresh(); Host::vcell = BATTERY_CUTOFF_V - 0.01f;
        ok(battery_too_low(true), "чуть ниже — блокировка");
    }

    // --------------------------------------------------------------------------------------------
    area("сон: источники пробуждения");
    {
        // ОТКАЗ 0.9.43: менеджер питания оставлял свой таймер пробуждения, и прибор просыпался
        // почти сразу, экран не трогал и засыпал снова — кнопка при этом не работала. Правило,
        // которым это закрыто: каждый сон начинается со снятия ВСЕХ источников, а таймер ставится
        // ПОСЛЕ.
        fresh();
        arm_wake_pins(UsbWake::None);
        ok(Host::sources_cleared >= 1, "вооружение начинается со снятия всех источников");
        eq_int(Host::armed_timer_us, 0, "и своего таймера при этом не ставит");
        ok(Host::armed_button, "кнопка вооружена");
    }
    {
        fresh(); Host::button_down = true;
        bool armed = arm_wake_pins(UsbWake::None);
        ok(!armed, "удерживаемая кнопка не вооружается — иначе сон кончился бы мгновенно");
    }
    {
        fresh();
        arm_wake_pins(UsbWake::OnPlug);
        ok(Host::armed_gpio_mask & (1ULL << PIN_USB_DETECT), "вставка кабеля вооружена");
        ok(Host::armed_gpio_mask & (1ULL << PIN_USER_BTN),   "и кнопка тоже");
    }

    // --------------------------------------------------------------------------------------------
    area("флеш: настоящие кольца над эмуляцией");
    {
        // Не украшение, а проверка самой оснастки: если бы вместо hist_store.cpp и evt_log.cpp
        // слинковались заглушки, ёмкость вышла бы нулевой или взятой из воздуха. Числа — из
        // main/partitions.csv: 1600K истории по 32 байта и 256K журнала по 32.
        fresh();
        HistStore::getInstance().init();
        eq_int(HistStore::getInstance().capacity(), 1600 * 1024 / (int)sizeof(HistRec),
               "ёмкость кольца истории выведена из размера раздела, а не задана числом");
        eq_int(HistStore::getInstance().capacity(), 51200, "то есть 51 200 записей, как на приборе");
        EvtLog::getInstance().init();
        eq_int(EvtLog::getInstance().capacity(), 256 * 1024 / (int)sizeof(EvtRec),
               "и журнал событий тоже");
        eq_int(EvtLog::getInstance().capacity(), 8192, "то есть 8192 слота");
    }
    {
        // Запись и чтение проходят через настоящий код кольца и эмуляцию флеша, которая умеет только
        // сбрасывать биты. Пустое кольцо не должно отдавать отметку времени: на этом стоит проверка
        // «часы читают раньше, чем уже записанные данные» в plan_tick().
        fresh();
        HistStore::getInstance().init();
        eq_int(HistStore::getInstance().newestTimestamp(), 0, "пустое кольцо не выдумывает отметку");
        HistRec r{}; r.t = (uint32_t)Host::wall; r.co2 = 612; r.temp_d = 221;
        HistStore::getInstance().append(r);
        eq_int(HistStore::getInstance().newestTimestamp(), (long)Host::wall,
               "записанное читается обратно — флеш в ОЗУ работает");
        ok(HistStore::getInstance().count() >= 1, "и запись посчитана");
    }

    // --------------------------------------------------------------------------------------------
    area("кольцо истории: оборот");
    {
        // Заголовок hist_store.h говорит прямо: «код на границе оборота ни на одном приборе не
        // исполнялся» — при обычной каденции кольцо заполняется 533 дня. Поэтому оборот проверяется
        // ЗДЕСЬ.
        //
        // И проверяется поверх СТАРЫХ данных, а не по чистому кольцу. Это и есть суть: эмуляция
        // флеша умеет только сбрасывать биты, как настоящая, поэтому запись в неочищенный слот даёт
        // побитовое И старого и нового. Забытое стирание сектора на обороте пройдёт незамеченным,
        // если писать в никогда не тронутые слоты, — а именно так и выглядел бы тест, написанный
        // по чистому кольцу.
        fresh();
        HistStore::getInstance().init();
        const uint32_t cap = HistStore::getInstance().capacity();

        // Сначала заполняем начало кольца: 200 записей — это больше одного сектора (128 записей по
        // 32 байта в 4096), значит слоты, в которые придёт оборот, уже заняты.
        HistStore::getInstance().debugSetHead(0, 0);
        for (int i = 0; i < 200; i++) {
            HistRec r{}; r.t = (uint32_t)Host::wall - 10000 + i; r.co2 = (uint16_t)(1000 + i);
            HistStore::getInstance().append(r);
        }
        // Теперь голова — за две записи до конца, кольцо полное. Оборот придёт на слоты 0, 1, 2.
        HistStore::getInstance().debugSetHead(cap - 2, cap);
        uint32_t newest = 0;
        for (int i = 0; i < 5; i++) {
            HistRec r{}; r.t = (uint32_t)Host::wall + i; r.co2 = (uint16_t)(700 + i);
            ok(HistStore::getInstance().append(r), "запись через границу кольца принята");
            newest = r.t;
        }
        eq_int(HistStore::getInstance().newestTimestamp(), (long)newest,
               "после оборота свежая отметка читается верно — сектор был стёрт перед записью");
        // Читаем обратно то, что записали: без стирания старая запись уцелела бы в побитовом И, и
        // ни отметка, ни CO2 не совпали бы.
        struct Ctx { uint32_t n; uint16_t last_co2; } c{0, 0};
        HistStore::getInstance().query((uint32_t)Host::wall, (uint32_t)Host::wall + 10, 16,
            [](const HistRec &r, void *ctx) {
                Ctx *k = (Ctx *)ctx; k->n++; k->last_co2 = r.co2;
            }, &c);
        eq_int(c.n, 5, "все пять записей найдены по обе стороны границы");
        eq_int(c.last_co2, 704, "и последняя читается без искажения");
    }
    {
        // Голова за пределами раздела при верной магии раньше не вызывала пересканирования, и
        // история молча переставала писаться (исправлено в 0.9.46).
        fresh();
        HistStore::getInstance().init();
        const uint32_t cap = HistStore::getInstance().capacity();
        HistStore::getInstance().debugSetHead(cap + 1000, 5);
        HistStore::getInstance().init();
        ok(HistStore::getInstance().debugHead() <= cap,
           "голова за пределами кольца приводится в диапазон, а не принимается как есть");
        HistRec r{}; r.t = (uint32_t)Host::wall; r.co2 = 555;
        ok(HistStore::getInstance().append(r), "и запись после этого продолжается");
    }

    // --------------------------------------------------------------------------------------------
    area("погода: мусор RTC после смены образа");
    {
        // ДЕФЕКТ 0.10.16, найден владельцем на приборе: в ячейках УФ, дождя и облачности стояли три
        // девятки. Причина — переменные RTC переезжают на новые адреса при каждой пересборке, а
        // четыре новых поля полосы обнулялись только в заводском сбросе. После обновления по воздуху
        // они читали чужие байты, большое случайное число проходило проверку «а его вообще забирали»,
        // и зажим, который держит snprintf внутри восьми байт, печатал правдоподобные 999.
        //
        // Проверяется не «поля обнулены», а именно СЦЕНАРИЙ: мусор -> смена образа -> сентинелы.
        auto trash = []() {
            rtc_wx_uv = 3.2e7f; rtc_wx_dew = 1.7e6f; rtc_wx_cloud = 1633771873;
            rtc_wx_lo = -412.0f; rtc_wx_hi = 918.0f;
            rtc_wx_temp = 1e9f; rtc_wx_feels = -1e9f; rtc_wx_wind = 7e8f; rtc_wx_hum = 30000;
            snprintf(rtc_wx_city, sizeof(rtc_wx_city), "%s", "\x7f\x7fмусор");
            rtc_day_lo = -500.0f; rtc_day_hi = 500.0f; rtc_day_stamp = 12345;
        };
        fresh(); EvtLog::getInstance().init();
        trash();
        forget_previous_build();
        // Ровно те поля, из-за которых всё началось (дождь снят 2026-09-28 вместе с ячейкой).
        ok(rtc_wx_uv    <  0.0f,   "смена образа: УФ вернулся в «не забирали»");
        ok(rtc_wx_cloud <  0,      "смена образа: облачность вернулась в «не забирали»");
        ok(rtc_wx_dew   <= -900.0f, "смена образа: точка росы вернулась в «не забирали»");
        // И остальное из того же блока — оно читало мусор с тем же успехом.
        ok(rtc_wx_lo >= 900.0f && rtc_wx_hi <= -900.0f, "смена образа: диапазон дня сброшен");
        eq_int(rtc_wx_city[0], 0, "смена образа: город забыт — иначе блок улицы покажет чужой");
        eq_int(rtc_wx_hum, 0, "смена образа: влажность улицы сброшена");
        eq_int(rtc_day_stamp, 0, "смена образа: накопленный день сброшен");
    }
    {
        fresh();
        rtc_wx_uv = 9e6f; rtc_wx_cloud = 88888; rtc_wx_dew = 5e5f;
        forget_rtc_state();
        ok(rtc_wx_uv < 0.0f && rtc_wx_cloud < 0 && rtc_wx_dew <= -900.0f,
           "заводской сброс делает то же самое — один блок на оба пути");
    }
    {
        // Вторая половина того же дефекта: сентинел и проверка в кадре должны совпадать. Разойдись
        // они — и «не забирали» снова станет числом. Значения берутся из самих переменных после
        // сброса, поэтому проверка сломается, если кто-то изменит сентинел, не тронув условие.
        fresh();
        forget_weather();
        ok(!(rtc_wx_uv    >= 0.0f),   "сентинел УФ не проходит проверку кадра (rtc_wx_uv >= 0)");
        ok(!(rtc_wx_cloud >= 0),      "сентинел облачности не проходит проверку кадра");
        ok(!(rtc_wx_dew   > -900.0f), "сентинел точки росы не проходит проверку кадра");
        ok(!(rtc_wx_lo < 900.0f && rtc_wx_hi > -900.0f), "сентинелы диапазона дня не проходят проверку");
    }

    // --------------------------------------------------------------------------------------------
    area("заводской сброс: что переживает, а что нет");
    {
        // Решение пользователя 2026-09-27: поправка температуры переживает сброс, как уже переживает
        // калибровка CO2. Обе — поправки для ЭТОГО датчика в ЭТОМ корпусе, то есть свойство прибора,
        // а не владельца. У CO2 это бесплатно (живёт в EEPROM датчика, и прошивка не шлёт ему
        // заводской сброс); у температуры — в NVS, которую сброс стирает целиком.
        fresh(); EvtLog::getInstance().init(); HistStore::getInstance().init();
        Host::set_float("scd_toff", 0.95f);
        Host::set_str("ssid", "HomeNet");
        Host::set_str("tg_tok", "секрет");
        Host::set_u8("provisioned", 1);
        factory_wipe();
        float toff = -1.0f;
        ok(NVSManager::getInstance().getFloat("toff_probe", toff, -1.0f) == false,
           "случайный ключ после сброса отсутствует — стирание действительно произошло");
        ok(!Host::has_key("ssid"),   "имя сети стёрто");
        ok(!Host::has_key("tg_tok"), "токен бота стёрт");
        ok(!Host::has_key("provisioned"), "признак настроенности стёрт");
        toff = -1.0f;
        ok(NVSManager::getInstance().getFloat("scd_toff", toff, -1.0f),
           "а поправка температуры на месте");
        near(toff, 0.95f, 0.001, "и это то самое значение, а не заводские 4.00");
    }
    {
        // Вне диапазона даташита 0..20 C это не калибровка, а мусор, и переносить его значит
        // закрепить ошибку навсегда: после сброса он попадёт в датчик как «уже применённый».
        fresh(); EvtLog::getInstance().init(); HistStore::getInstance().init();
        Host::set_float("scd_toff", 50.0f);
        factory_wipe();
        ok(!Host::has_key("scd_toff"), "поправка вне 0..20 C не переносится");
    }
    {
        // Ничего не калибровали — переносить нечего, и ключ не должен появиться из воздуха:
        // его отсутствие и есть сигнал «взять значение из EEPROM датчика» (scd_sync_offset).
        fresh(); EvtLog::getInstance().init(); HistStore::getInstance().init();
        factory_wipe();
        ok(!Host::has_key("scd_toff"),
           "без калибровки ключ не создаётся — иначе путь «взять из датчика» стал бы недостижим");
    }

    area("батарея: плата v2, делитель и STDBY");
    {
        // Ревизия определяется по шине, а не флагом сборки: один образ идёт на обе платы, значит и
        // обновление по воздуху у них общее.
        // Каждый случай со своей загрузки: это РАЗНЫЕ платы, а не плата, сменившая себя на ходу.
        fresh(); I2CManager::getInstance().init();
        ok(BatterySource::revision(I2CManager::getInstance().getBusHandle())
               == BatterySource::RevGaugeV1, "газомер ответил — плата v1");
    }
    {
        fresh(); Host::gauge_ok = false; I2CManager::getInstance().init();
        ok(BatterySource::revision(I2CManager::getInstance().getBusHandle())
               == BatterySource::RevDividerV2, "газомера нет, но шина жива — плата v2");
    }
    {
        fresh(); Host::gauge_ok = false; Host::sensors_present = false;
        I2CManager::getInstance().init();
        ok(BatterySource::revision(I2CManager::getInstance().getBusHandle())
               == BatterySource::RevUnknown,
           "молчит вся шина — ревизия неизвестна, и выдумывать её нечем");
    }
    {
        // Определённый ответ спрашивается ОДИН раз за загрузку. Это не экономия: драйвер берёт
        // блокировку шины с таймаутом, и проба из задачи httpd, посланная пока задача цикла говорит
        // с датчиком, может истечь. Проиграй эту гонку проба по 0x36, а проба датчика выиграй — и
        // плата v1 объявит себя v2, уйдя искать ячейку на неподключённом выводе.
        fresh(); I2CManager::getInstance().init();
        auto bus = I2CManager::getInstance().getBusHandle();
        BatterySource::revision(bus);
        const int after_first = Host::i2c_probes;
        for (int i = 0; i < 20; i++) BatterySource::revision(bus);
        ok(Host::i2c_probes == after_first,
           "определённая ревизия больше шину не трогает, сколько её ни спрашивай");
    }
    {
        // А вот «не знаю» не запоминается никогда: шина, лежавшая в момент одной пробы, поднимется,
        // и закэшированное неведение заперло бы прибор от собственной ячейки навсегда.
        fresh(); Host::bus_ok = false; I2CManager::getInstance().init();
        auto bus = I2CManager::getInstance().getBusHandle();
        ok(BatterySource::revision(bus) == BatterySource::RevUnknown, "шина лежит — не знаю");
        Host::bus_ok = true; Host::gauge_ok = false;
        ok(BatterySource::revision(bus) == BatterySource::RevDividerV2,
           "шина вернулась — ревизия определяется, «не знаю» не залипло");
    }
    {
        // Почему различение вообще нужно: на v1 к IO4 не подключено ничего, и чтение делителя там
        // измерило бы болтающийся вывод, отдав правдоподобное число вместо честного «не знаю».
        // Низкое такое число заперло бы исправный прибор от его же ячейки.
        fresh(); Host::gauge_ok = false; Host::sensors_present = false;
        I2CManager::getInstance().init();
        float v = -1.0f;
        ok(!BatterySource::readVoltage(I2CManager::getInstance().getBusHandle(), v),
           "ревизия неизвестна — не читаем ни один вывод");
    }
    {
        // Арифметика делителя в прошивке против номиналов резисторов в оснастке. Это два
        // независимых прочтения одного чертежа; разойдутся — упадёт здесь.
        fresh(); Host::gauge_ok = false; Host::vcell = 4.11f;
        I2CManager::getInstance().init();
        float v = 0.0f;
        ok(BatterySource::readVoltage(I2CManager::getInstance().getBusHandle(), v),
           "делитель читается");
        ok(fabsf(v - 4.11f) < 0.01f,
           "и отдаёт напряжение ЯЧЕЙКИ, а не напряжение на выводе");
    }
    {
        // Без калибровки АЦП — отказ, а не сырое число: оно кормит единственный программный рубеж
        // этой ячейки, и ошибиться в нём дороже, чем промолчать.
        fresh(); Host::gauge_ok = false; Host::adc_cali_ok = false;
        I2CManager::getInstance().init();
        float v = 0.0f;
        ok(!BatterySource::readVoltage(I2CManager::getInstance().getBusHandle(), v),
           "нет калибровки — отказ, а не догадка");
    }
    {
        // STDBY#: подтяжка включается только при вставленном кабеле, иначе мы толкали бы ток в
        // обесточенный зарядник через его же выход.
        fresh(); Host::stdby_low = true;
        ok(BatterySource::chargeComplete(false) == -1, "без кабеля не отвечаем и не подтягиваем");
        ok(BatterySource::chargeComplete(true) == 1, "STDBY в нуле — заряд завершён");
        Host::stdby_low = false;
        ok(BatterySource::chargeComplete(true) == 0, "линия отпущена — ещё заряжает");
    }
    {
        // Два свойства кривой обязаны пережить любую замену таблицы, в том числе новый прогон стенда.
        // Для КАЖДОЙ ячейки: с 2026-10-08 их две, и вторая не имеет права быть исключением.
        using BatterySource::Cell;
        for (Cell c : { BatterySource::Cell804050, BatterySource::Cell103450 }) {
            const char *nm = c == BatterySource::Cell804050 ? "804050" : "103450";
            ok(BatterySource::socFromVoltage(4.25f, c) >= 99.9f,
               (std::string(nm) + ": полная ячейка — сто процентов").c_str());
            ok(BatterySource::socFromVoltage(BATTERY_CUTOFF_V, c) <= 0.01f,
               (std::string(nm) + ": ноль стоит на пороге отключения, а не на настоящем нуле ячейки: "
               "иначе прибор выключался бы при показанных восьми процентах, и это читалось бы как поломка").c_str());
            bool mono = true; float prev = -1.0f;
            for (int mv = 3300; mv <= 4250; mv += 1) {
                const float pc = BatterySource::socFromVoltage(mv / 1000.0f, c);
                if (pc < prev - 0.001f) mono = false;
                prev = pc;
            }
            ok(mono, (std::string(nm) + ": и она монотонна: больше напряжения — не меньше процентов").c_str());
        }
    }
    {
        // Какая ячейка на какой плате — факт владельца 2026-10-06: полевой v1 несёт 103450, все v2 —
        // 804050. Выбирает ревизия, потому что больше изнутри это узнать нечем.
        ok(BatterySource::cellFor(BatterySource::RevGaugeV1) == BatterySource::Cell103450,
           "плата v1 — ячейка 103450");
        ok(BatterySource::cellFor(BatterySource::RevDividerV2) == BatterySource::Cell804050,
           "плата v2 — ячейка 804050");
        // Плато 103450 — то, ради чего у неё своя таблица: 70..90 % на 34 мВ. Числа — из журнала
        // стенда f708 (второй разряд), а не сняты с этого кода.
        near(BatterySource::socFromVoltage(4.046f, BatterySource::Cell103450), 85.0, 0.01,
             "103450: 4,046 В — 85 %");
        near(BatterySource::socFromVoltage(4.026f, BatterySource::Cell103450), 70.0, 0.01,
             "103450: 4,026 В — 70 %");
        ok(BatterySource::socFromVoltage(4.040f, BatterySource::Cell804050)
               - BatterySource::socFromVoltage(4.040f, BatterySource::Cell103450) > 10.0f,
           "на том же напряжении таблицы расходятся больше чем на десять пунктов — "
           "одна таблица на обе ячейки была бы ошибкой, а не упрощением");
    }
    {
        // Рубеж по разряду работает и без газомера: он сравнивает вольты с вшитым порогом и
        // процентов не спрашивает. На плате v2 он вообще единственный.
        fresh(); Host::gauge_ok = false; Host::vcell = BATTERY_CUTOFF_V - 0.05f;
        ok(battery_too_low(true), "ячейка ниже порога — блокировка, хотя газомера нет");
        fresh(); Host::gauge_ok = false; Host::vcell = 3.90f;
        ok(!battery_too_low(true), "здоровая ячейка через делитель блокировки не даёт");
    }

    {
        // Парковка спрашивает ревизию, а не тычется в газомер вслепую. MAX17048::init() ничего у
        // микросхемы не спрашивает — он только добавляет её на шину, — поэтому на плате без
        // газомера прежний код печатал «initialized successfully» и следом ОШИБКУ записи: две
        // строки, вместе читающиеся как поломка, про деталь, которой там нет по проекту.
        fresh(); I2CManager::getInstance().init();
        BatterySource::park(I2CManager::getInstance().getBusHandle());
        ok(Host::gauge_writes > 0, "на плате v1 газомер паркуется — в него пишут");

        fresh(); Host::gauge_ok = false; I2CManager::getInstance().init();
        BatterySource::park(I2CManager::getInstance().getBusHandle());
        ok(Host::gauge_writes == 0,
           "на плате v2 в газомер НЕ пишут вовсе: отсутствующая деталь не должна давать ошибку в лог");
    }
    {
        // Ревизия называется в логе. Это не косметика: от неё зависит, откуда читается ячейка и с
        // чем сравнивает порог отключения, а до этой правки узнать её можно было только по
        // ОТСУТСТВИЮ строки об ошибке где-то в другом месте лога.
        fresh(); I2CManager::getInstance().init();
        BatterySource::revision(I2CManager::getInstance().getBusHandle());
        ok(Host::logged("board v1"), "плата v1 названа в логе");

        fresh(); Host::gauge_ok = false; I2CManager::getInstance().init();
        BatterySource::revision(I2CManager::getInstance().getBusHandle());
        ok(Host::logged("board v2"), "плата v2 названа в логе");

        fresh(); Host::bus_ok = false; I2CManager::getInstance().init();
        BatterySource::revision(I2CManager::getInstance().getBusHandle());
        ok(Host::logged("cannot tell which board"),
           "и молчащая шина тоже названа — «не знаю» должно быть видно, а не выглядеть как v2");
    }

    area("батарея: поправка делителя");
    {
        // Множитель применяется к КАЖДОМУ чтению. Величина сверяется с арифметикой, а не с
        // «стало больше»: проверка вида «поправка что-то делает» проходит и на сломанной поправке.
        fresh(); Host::gauge_ok = false; Host::vcell = 4.00f;
        BatterySource::forgetBoard();
        I2CManager::getInstance().init();
        auto bus = I2CManager::getInstance().getBusHandle();

        float raw = 0.0f;
        ok(BatterySource::readRawVoltage(bus, raw) && fabsf(raw - 4.00f) < 0.01f,
           "сырое чтение отдаёт то, что видит железо");

        Host::set_float("bat_cal", 0.9828f);
        BatterySource::forgetBoard();
        float v = 0.0f;
        ok(BatterySource::readVoltage(bus, v) && fabsf(v - 4.00f * 0.9828f) < 0.005f,
           "с поправкой чтение умножается ровно на неё");

        float raw2 = 0.0f;
        ok(BatterySource::readRawVoltage(bus, raw2) && fabsf(raw2 - 4.00f) < 0.01f,
           "а СЫРОЕ чтение остаётся сырым — иначе калибровка возводила бы поправку в квадрат");
    }
    {
        // Зажим. Поправка кормит BATTERY_CUTOFF_V, единственный программный рубеж ячейки:
        // опечатка в эталоне без зажима двигала бы порог куда угодно, вплоть до блокировки на
        // полной ячейке, снять которую нечем — проверка идёт раньше радио, экрана и консоли.
        fresh(); Host::gauge_ok = false; Host::vcell = 4.00f;
        Host::set_float("bat_cal", 0.75f);
        BatterySource::forgetBoard();
        I2CManager::getInstance().init();
        float v = 0.0f;
        ok(BatterySource::readVoltage(I2CManager::getInstance().getBusHandle(), v)
               && fabsf(v - 4.00f) < 0.01f,
           "поправка вне диапазона игнорируется — прибор просто некалиброван, а не заперт");
        ok(fabsf(BatterySource::calibration() - BatterySource::CAL_NONE) < 1e-6f,
           "и наружу отдаётся единица, а не сохранённый мусор");
    }
    {
        // Сама калибровка: множитель = эталон / СЫРОЕ чтение, поэтому она идемпотентна.
        fresh(); Host::gauge_ok = false; Host::vcell = 4.07f;
        BatterySource::forgetBoard();
        I2CManager::getInstance().init();
        auto bus = I2CManager::getInstance().getBusHandle();

        float f1 = 0.0f, r1 = 0.0f;
        ok(BatterySource::calibrate(bus, 4.00f, f1, r1), "калибровка по эталону принята");
        ok(fabsf(f1 - 4.00f / 4.07f) < 0.001f, "множитель — это эталон, делённый на сырое чтение");

        float shown = 0.0f;
        ok(BatterySource::readVoltage(bus, shown) && fabsf(shown - 4.00f) < 0.005f,
           "и следующее же чтение показывает эталон, без перезагрузки");

        float f2 = 0.0f, r2 = 0.0f;
        ok(BatterySource::calibrate(bus, 4.00f, f2, r2) && fabsf(f2 - f1) < 1e-6f,
           "повтор с тем же эталоном даёт ТО ЖЕ число: дважды нажатая кнопка не возводит поправку "
           "в квадрат — это и есть причина считать от сырого чтения");
    }
    {
        // Отказы калибровки. Каждый обязан оставить NVS в покое.
        fresh(); Host::gauge_ok = false; Host::vcell = 4.00f;
        BatterySource::forgetBoard();
        I2CManager::getInstance().init();
        auto bus = I2CManager::getInstance().getBusHandle();
        float f = 0.0f, r = 0.0f;

        ok(!BatterySource::calibrate(bus, 3.20f, f, r),
           "эталон дальше пяти процентов от чтения — отказ: так выглядит опечатка, а не допуск");
        ok(!Host::has_key("bat_cal"), "и в NVS ничего не записано");
        ok(!BatterySource::calibrate(bus, 0.0f, f, r), "пустое поле — отказ");
        ok(!BatterySource::calibrate(bus, 9.0f, f, r), "напряжение не из жизни лития — отказ");
        ok(!Host::has_key("bat_cal"), "ни один отказ ключа не создал");
    }
    {
        // Плата v1 не калибруется руками: у MAX17048 свой источник опорного напряжения, и
        // подкручивать откалиброванную деталь значит делать её хуже.
        fresh(); Host::vcell = 4.00f;
        BatterySource::forgetBoard();
        I2CManager::getInstance().init();
        auto bus = I2CManager::getInstance().getBusHandle();
        float f = 0.0f, r = 0.0f;
        ok(!BatterySource::calibrate(bus, 4.00f, f, r), "на плате с газомером калибровка отклонена");
        ok(!BatterySource::readRawVoltage(bus, r), "и сырого чтения делителя там не существует");
    }
    {
        // Переживает заводской сброс — как поправка температуры. У этой причина острее: копии нет
        // нигде. Температуру можно взять из EEPROM датчика, CO2 оттуда и не уходит, а это число
        // описывает резисторы и АЦП ЭТОЙ платы и живёт только здесь. Потеря молча сдвинула бы порог.
        fresh(); EvtLog::getInstance().init(); HistStore::getInstance().init();
        BatterySource::forgetBoard();
        Host::set_float("bat_cal", 0.9828f);
        factory_wipe();
        float kept = 0.0f;
        ok(NVSManager::getInstance().getFloat("bat_cal", kept, 1.0f) && fabsf(kept - 0.9828f) < 1e-5f,
           "поправка напряжения ячейки пережила заводской сброс");
    }
    {
        // Мусор через сброс не переносится: перенести значение вне диапазона значило бы закрепить
        // ошибку навсегда, а не сохранить калибровку.
        fresh(); EvtLog::getInstance().init(); HistStore::getInstance().init();
        BatterySource::forgetBoard();
        Host::set_float("bat_cal", 0.5f);
        factory_wipe();
        ok(!Host::has_key("bat_cal"), "поправка вне диапазона через сброс не переносится");
    }
    {
        // И то, ради чего всё это: поправка двигает ПОРОГ ОТКЛЮЧЕНИЯ. Без неё плата, завышающая
        // на 1,8 %, охраняла бы ячейку на 3,24 В, считая, что охраняет 3,30.
        fresh(); Host::gauge_ok = false;
        BatterySource::forgetBoard();
        Host::set_float("bat_cal", 0.9828f);
        Host::vcell = BATTERY_CUTOFF_V / 0.9828f + 0.02f;      // чуть выше порога ПОСЛЕ поправки
        ok(!battery_too_low(true), "выше порога по исправленному напряжению — блокировки нет");

        fresh(); Host::gauge_ok = false;
        BatterySource::forgetBoard();
        Host::set_float("bat_cal", 0.9828f);
        Host::vcell = BATTERY_CUTOFF_V / 0.9828f - 0.02f;      // чуть ниже
        ok(battery_too_low(true),
           "ниже — блокировка, то есть рубеж считает по исправленному напряжению, а не по сырому");
    }

    // --------------------------------------------------------------------------------------------
    area("батарея: как читается делитель");
    auto v2_bus = []() {
        Host::gauge_ok = false;
        I2CManager::getInstance().init();
        return I2CManager::getInstance().getBusHandle();
    };
    {
        // Выбросы. Каждое восьмое преобразование — рельс, по очереди вверх и вниз: так выглядит
        // вспышка Wi-Fi на питании, пока открыта консоль. Простое среднее ушло бы на десятые доли
        // вольта; усечённое отрезает их вместе с хвостами.
        fresh(); auto bus = v2_bus(); Host::vcell = 3.90f; Host::adc_spike_every = 8;
        float v = 0.0f;
        ok(BatterySource::readVoltage(bus, v) && fabsf(v - 3.90f) < 0.003f,
           "выбросы к рельсам отрезаны — чтение не сдвинулось");
    }
    {
        // Первые преобразования после настройки канала выбрасываются. Двенадцать нулей — больше,
        // чем одна усечка может проглотить (восемь с краю): проверка держит и отброс, и усечку
        // вместе, и падает, если снять любое из двух.
        fresh(); auto bus = v2_bus(); Host::vcell = 3.90f; Host::adc_settle_bad = 12;
        float v = 0.0f;
        ok(BatterySource::readVoltage(bus, v) && fabsf(v - 3.90f) < 0.003f,
           "первые преобразования после настройки канала не попадают в среднее");
    }
    {
        // Перевод кода в милливольты. Калибровка ESP-IDF отвечает ЦЕЛЫМИ милливольтами, а милливольт
        // на узле — это 3,6 мВ ячейки, целый процент в середине кривой. Прошивка ведёт прямую через
        // кривую вокруг среднего; округление до кода дало бы лестницу до 1,8 мВ.
        fresh(); auto bus = v2_bus(); Host::adc_mv_per_code = 0.3174f;   // 1300 мВ на 4096 кодов
        float worst = 0.0f, prev = 0.0f; bool mono = true;
        for (int mv = 3700; mv <= 3720; mv++) {
            Host::vcell = mv / 1000.0f;
            float v = 0.0f;
            BatterySource::readVoltage(bus, v);
            worst = fmaxf(worst, fabsf(v - Host::vcell));
            if (v < prev - 1e-6f) mono = false;
            prev = v;
        }
        ok(worst < 0.0010f, "шаг ячейки в милливольт читается с ошибкой меньше милливольта, "
                            "а не лестницей целых милливольт узла");
        ok(mono, "и монотонно: больше напряжения — не меньше чтения");
    }
    {
        // Второй взгляд стоит денег только там, где он нужен.
        fresh(); auto bus = v2_bus(); Host::vcell = 3.90f;
        float v = 0.0f;
        BatterySource::readVoltage(bus, v);
        eq_int(Host::adc_bursts, 1, "далеко от порога — одна вспышка");
    }
    {
        // Провал под нагрузкой ровно на одной вспышке: лампа CO2, насос панели. Это настоящее
        // напряжение, но не заряд ячейки. Блокировка липкая — снимается на пороге плюс 0,15 В, то
        // есть зарядником, — и одна такая вспышка остановила бы исправный прибор до зарядки.
        fresh(); v2_bus(); Host::vcell = 3.90f;
        Host::adc_glitch_bursts = 1; Host::adc_glitch_v = BATTERY_CUTOFF_V - 0.10f;
        ok(!battery_too_low(true), "один провал у порога не запирает прибор");
        ok(!rtc_lockout, "и флаг не выставлен");
        ok(Host::logged("second look"), "второй взгляд назван в логе");
    }
    {
        fresh(); v2_bus(); Host::vcell = BATTERY_CUTOFF_V - 0.02f;
        ok(battery_too_low(true), "а севшая ячейка читается низко дважды — блокировка");
        eq_int(Host::adc_bursts, 2, "ровно двумя вспышками");
    }

    area("батарея: калибровка делителя, строже");
    {
        fresh(); auto bus = v2_bus(); Host::vcell = 4.07f;
        float f = 0.0f, r = 0.0f; BatterySource::CalError why = BatterySource::CalRange;
        ok(BatterySource::calibrate(bus, 4.00f, f, r, &why) && why == BatterySource::CalOk,
           "спокойная ячейка — калибровка принята");
        ok(Host::adc_bursts >= 32, "эталон сверяется со средним 32 вспышек, а не с одной");
        float v = 0.0f;
        ok(BatterySource::readVoltage(bus, v),
           "и после неё АЦП свободен: ни один путь не оставляет блок открытым");
    }
    {
        // Ячейка плывёт, пока человек переписывает показание мультиметра: 5 мВ на вспышку, среднее
        // второй половины на 80 мВ выше первой. Прибор и мультиметр смотрели на разные напряжения —
        // поправка из этого была бы ошибкой, записанной навсегда.
        fresh(); auto bus = v2_bus(); Host::vcell = 4.00f; Host::adc_burst_drift_v = 0.005f;
        float f = 0.0f, r = 0.0f; BatterySource::CalError why = BatterySource::CalOk;
        ok(!BatterySource::calibrate(bus, 4.00f, f, r, &why) && why == BatterySource::CalUnstable,
           "чтение плывёт — отказ «unstable»");
        ok(!Host::has_key("bat_cal"), "и в NVS ничего");
    }
    {
        // А медленно оседающая ячейка — нормальна: 0,3 мВ на вспышку, половины расходятся на 5 мВ.
        fresh(); auto bus = v2_bus(); Host::vcell = 4.00f; Host::adc_burst_drift_v = 0.0003f;
        float f = 0.0f, r = 0.0f;
        ok(BatterySource::calibrate(bus, 4.00f, f, r), "медленное оседание принимается");
    }
    {
        // 2026-09-30, стенд: на батарее с поднятым радио вспышки разбросаны на десятки милливольт —
        // каждая передача Wi-Fi на миг просаживает ячейку. Первая версия отказывала по разбросу, то
        // есть ВСЕГДА, и принимала шум радио за «напряжение плывёт». Разброс ±20 мВ без дрейфа
        // среднего обязан приниматься, и поправка — считаться по СРЕДНЕМУ, как усредняет мультиметр.
        fresh(); auto bus = v2_bus(); Host::vcell = 4.07f; Host::adc_burst_noise_v = 0.020f;
        float f = 0.0f, r = 0.0f; BatterySource::CalError why = BatterySource::CalRange;
        BatterySource::CalStats st;
        ok(BatterySource::calibrate(bus, 4.00f, f, r, &why, false, &st) && why == BatterySource::CalOk,
           "шум радио ±20 мВ без дрейфа — калибровка принята");
        ok(fabsf(r - 4.07f) < 0.002f, "сырое — среднее вспышек, а не одна из них");
        ok(st.sd_mv > 15.0f && fabsf(st.drift_mv) < 2.0f, "и разброс с дрейфом отданы наружу, для страницы");
    }
    {
        // Шум не прячет ЯВНЫЙ дрейф: тот же разброс, и ещё 3 мВ на вспышку — половины расходятся на
        // 48 мВ, больше четырёх стандартных ошибок. (Дрейф в 16 мВ при таком шуме — это 2,2 ошибки,
        // шум сам даёт такое в трёх случаях из ста, и отказ по нему вернул бы отказы от радио.)
        fresh(); auto bus = v2_bus(); Host::vcell = 4.00f;
        Host::adc_burst_noise_v = 0.020f; Host::adc_burst_drift_v = 0.003f;
        float f = 0.0f, r = 0.0f; BatterySource::CalError why = BatterySource::CalOk;
        ok(!BatterySource::calibrate(bus, 4.00f, f, r, &why) && why == BatterySource::CalUnstable,
           "шум вместе с настоящим дрейфом — отказ «unstable»");
    }
    {
        // На зарядке через разъём идёт ампер, и ячейка с делителем расходятся на десятки милливольт
        // — ровно на размер исправляемой ошибки.
        fresh(); auto bus = v2_bus(); Host::vcell = 4.00f;
        float f = 0.0f, r = 0.0f; BatterySource::CalError why = BatterySource::CalOk;
        ok(!BatterySource::calibrate(bus, 4.00f, f, r, &why, /*on_usb=*/true)
               && why == BatterySource::CalOnCharger,
           "на кабеле — отказ «charger»");
        ok(!Host::has_key("bat_cal"), "и в NVS ничего");
    }
    {
        // Калибровка сбрасывает среднее: оно было накоплено в старых единицах и полчаса тянуло бы
        // процент назад, к неисправленному напряжению.
        fresh(); auto bus = v2_bus(); Host::vcell = 3.85f;
        BatterySource::smoothed(3.80f, 1000.0, false);
        float f = 0.0f, r = 0.0f;
        BatterySource::calibrate(bus, 3.85f, f, r);
        ok(fabsf(BatterySource::smoothed(3.85f, 1300.0, false) - 3.85f) < 1e-6f,
           "после калибровки среднее начинается заново");
    }

    area("батарея: среднее для процентов");
    {
        fresh();
        ok(fabsf(BatterySource::smoothed(3.800f, 1000.0, false) - 3.800f) < 1e-6f,
           "первое чтение берётся как есть");
        const float a = 1.0f - expf(-300.0f / 1800.0f);
        const float s2 = BatterySource::smoothed(3.820f, 1300.0, false);
        ok(fabsf(s2 - (3.800f + a * 0.020f)) < 1e-5f,
           "через пять минут — на долю 1-e^(-300/1800) пути, а не на весь");
        ok(fabsf(BatterySource::smoothed(3.820f, 1300.0, false) - s2) < 1e-6f,
           "второе чтение в ту же секунду не весит ничего: вес — время, а не число нажатий");
    }
    {
        // Напряжения ближе 0,1 В друг к другу нарочно: при большом разрыве среднее начиналось бы
        // заново по скачку, и проверка прошла бы без правила про кабель вовсе.
        fresh(); BatterySource::smoothed(4.10f, 1000.0, false);
        ok(fabsf(BatterySource::smoothed(4.15f, 1060.0, true) - 4.15f) < 1e-6f,
           "на кабеле — как есть: там процент держит потолок заряда, а не напряжение");
        ok(fabsf(BatterySource::smoothed(4.12f, 1120.0, false) - 4.12f) < 1e-6f,
           "и после кабеля начинается заново, а не тянется из того, что было до него");
    }
    {
        fresh(); BatterySource::smoothed(3.80f, 1000.0, false);
        ok(fabsf(BatterySource::smoothed(3.85f, 1000.0 + 4 * 3600, false) - 3.85f) < 1e-6f,
           "разрыв больше трёх часов — заново");
        fresh(); BatterySource::smoothed(3.80f, 1000.0, false);
        ok(fabsf(BatterySource::smoothed(3.85f, 500.0, false) - 3.85f) < 1e-6f,
           "часы пошли назад (первая синхронизация) — заново");
        fresh(); BatterySource::smoothed(3.80f, 1000.0, false);
        ok(fabsf(BatterySource::smoothed(3.95f, 1300.0, false) - 3.95f) < 1e-6f,
           "скачок больше 0,1 В — другая ячейка, заново");
    }
    {
        // То, ради чего среднее: шесть милливольт восстановления после радиоокна. По сырому
        // напряжению это полтора пункта, а подъём больше пункта перезакрепляет наклон разряда — и
        // «дней осталось» не посчиталось бы никогда.
        fresh(); auto bus = v2_bus(); Host::vcell = 3.800f;
        BatteryInfo bi;
        BatteryMonitor::getInstance().update(bus, 1000.0, bi, false);
        const float soc0 = bi.soc;
        Host::vcell = 3.806f;
        BatteryMonitor::getInstance().update(bus, 1300.0, bi, false);
        ok(fabsf(bi.voltage - 3.806f) < 0.002f, "напряжение уходит наружу как измерено — это измерение");
        ok(bi.soc - soc0 < 0.5f, "а процент от шести милливольт почти не двинулся");
        ok(BatterySource::socFromVoltage(3.806f) - soc0 > 1.0f,
           "хотя по сырому напряжению это был бы больше чем пункт — иначе проверка ничего не доказывает");
    }
    {
        // BatteryMonitor::begin() спрашивает ревизию, а не gauge.init(): тот лишь добавляет
        // устройство на шину и у микросхемы ничего не спрашивает.
        fresh(); auto bus = v2_bus();
        BatteryMonitor::getInstance().begin(bus);
        eq_int(Host::gauge_writes, 0, "на плате v2 подготовка газомера в него не пишет");
        ok(Host::logged("running on the divider"), "и говорит, что работает от делителя");
    }

    {
        // 2026-09-30, плата v2, залитая по кабелю: «battery 1 % (4.15 V)». Якорь потолка заряда
        // живёт в RTC_NOINIT, новая сборка читает его через сдвинутую раскладку, а нулевые байты — это
        // 0,0 %, вполне «известный» якорь. На кабеле прибор показывал ноль плюс минуты с загрузки.
        // Воспроизведено честно: якорь ставится настоящим чтением на почти пустой ячейке, потом смена
        // образа, потом кабель и полная ячейка.
        fresh(); auto bus = v2_bus();
        BatteryInfo bi;
        Host::vcell = BATTERY_CUTOFF_V + 0.01f;                      // якорь около нуля
        BatteryMonitor::getInstance().update(bus, 1000.0, bi, false);
        ok(bi.soc < 2.0f, "(якорь поставлен около нуля — иначе проверка ничего не доказывает)");
        forget_previous_build();
        Host::vcell = 4.15f;
        BatteryMonitor::getInstance().update(bus, 1060.0, bi, true);
        ok(bi.soc > 80.0f, "после смены образа старый якорь не держит процент на кабеле у нуля");
    }

    {
        // 2026-09-30, лог платы v2: «E MAX17048: Read reg 0x0C failed» на каждом замерочном тике.
        // Поправка газомера на температуру звалась по успеху gauge.init(), а тот у микросхемы ничего
        // не спрашивает. Весь путь замера на плате без газомера не должен трогать 0x36 вовсе.
        fresh(); v2_bus(); Host::vcell = 3.95f; rtc_temp = 21.0f;
        float co2 = 0, t = 0, h = 0, pres = 0, iaq = 0, soc = 0; uint8_t acc = 0;
        read_sensors(co2, t, h, pres, iaq, acc, soc, /*with_co2=*/false, /*with_gas=*/false);
        eq_int(Host::gauge_reads, 0, "замер на плате v2 газомер не читает");
        eq_int(Host::gauge_writes, 0, "и не пишет");
    }

    area("батарея: идущий заряд — не полная ячейка");
    {
        // Найдено на приборе 2026-10-08: плата v2 на заряднике показывала 100 %, а светодиод
        // TP4056 ещё горел. Кривая измерена по напряжению ПОКОЯ (полная 804050 — 4,058 В), а
        // зарядник держит около 4,2 В, так что верх кривой достигается задолго до прекращения
        // заряда. Правило «закончил → 100» было, правила «не закончил → не 100» не было.
        fresh();
        const float charging = BatterySource::percent(4.200f, 1000.0, /*on_usb=*/true,
                                                      /*charge_done=*/false);
        ok(charging <= BatterySource::CHARGING_MAX_PCT,
           "на заряднике, пока он не закончил, процент не доходит до 100");
        // И это именно потолок, а не «кривая так сказала»: без него тот же вход даёт 100.
        ok(BatterySource::socFromVoltage(4.200f) > BatterySource::CHARGING_MAX_PCT,
           "а сама кривая на этом напряжении сказала бы больше");
        // Потолок обязан быть ниже 100, иначе он ничего не ограничивает.
        ok(BatterySource::CHARGING_MAX_PCT < 100.0f, "потолок ниже 100");

        // Зарядник сказал «готово» — вот теперь 100, и ровно 100.
        fresh();
        ok(fabsf(BatterySource::percent(4.200f, 1000.0, true, /*charge_done=*/true) - 100.0f) < 1e-6f,
           "как только зарядник закончил — 100 %");

        // Потолок не трогает ни батарею, ни середину кривой.
        fresh();
        const float mid = BatterySource::percent(3.800f, 1000.0, true, false);
        ok(mid < BatterySource::CHARGING_MAX_PCT - 5.0f,
           "в середине кривой потолок ничего не меняет");
        fresh();
        ok(BatterySource::percent(4.200f, 1000.0, /*on_usb=*/false, false) > BatterySource::CHARGING_MAX_PCT,
           "а без кабеля потолка нет вовсе: там идущего заряда не бывает");
    }

    area("батарея: молния идёт за зарядником, а не за процентом");
    {
        // Найдено владельцем на приборе 2026-10-13: вилка, 99 %, светодиод заряда TP4056 горит — а
        // молнии на значке нет. Условие молнии требовало ещё и rtc_soc < 99, а потолок, добавленный
        // 2026-10-08, пришпиливает показанный процент РОВНО к 99 на весь остаток заряда. То есть
        // молния гасла, как только ячейка подходила к полной, и не возвращалась до конца — а это
        // почти весь заряд: постоянный ток кончается на ~42 % отданного, хвост идёт около 3,5 часов.
        // Проверяется через НАСТОЯЩУЮ сборку кадра: draw_dashboard() складывает Frame и кладёт его
        // в rtc_prev, поэтому спрашивается то, что ушло на стекло, а не копия условия.
        auto bolt = [](float soc, float volts, float crate, bool usb) {
            fresh();
            rtc_bat_rev = (uint8_t)BatterySource::RevGaugeV1;  // «готово» выводится из вольт и скорости
            rtc_temp = 21.0f;                                  // вне 2…50 °C панель не рисуют вовсе
            rtc_soc = soc; rtc_volt = volts; rtc_crate = crate;
            Host::usb_in = usb;
            EPaper e; e.init();
            // Спрашивается rtc_prev, а НЕ rtc_prev_valid: тот ставится по ответу панели
            // (`rtc_prev_valid = panel_ok`), а заглушка сессию не подтверждает, то есть он здесь
            // всегда ложь. С ним три проверки «молнии нет» проходили бы, не глядя на кадр вовсе —
            // поймано диагностикой при первом же прогоне. Кадр кладётся в rtc_prev безусловно.
            const int drawn = draw_dashboard(e, /*full=*/true, /*night=*/false,
                                             /*offline=*/true, /*live_clock=*/false);
            ok(drawn != 0, "кадр собран и сложен (иначе проверка ниже ни на что не смотрит)");
            return rtc_prev.chg;
        };
        ok(bolt(BatterySource::CHARGING_MAX_PCT, 4.05f, 20.0f, true),
           "на потолке 99 % молния горит: зарядник не закончил");
        ok(!bolt(BatterySource::CHARGING_MAX_PCT, 4.15f, 0.1f, true),
           "а когда он закончил — гаснет");
        ok(!bolt(BatterySource::CHARGING_MAX_PCT, 4.05f, 20.0f, false),
           "без кабеля её нет вовсе");
        ok(!bolt(0.0f, 4.05f, 20.0f, true),
           "и пока заряд не прочитан — тоже");
        ok(bolt(50.0f, 3.90f, 20.0f, true),
           "в середине заряда горит, как и раньше");
    }

    area("батарея: кабель на минуту — слой отображения его видит");
    {
        // Найдено владельцем 2026-10-29 на подарочном e004: полный прибор воткнут, зарядник сразу
        // сказал «готово» (светодиод не загорелся), на стекле 100 %; вынут через минуту — 96 %.
        // Правило «100 % четыре часа после законченного заряда» живёт в слое отображения, а тот
        // читал батарею только на замерочных тиках, раз в пять минут, и кабеля не увидел вовсе.
        // Стекло же на кабеле берёт «готово» у зарядника напрямую (shown_battery). Здесь — путь
        // пробуждения без замера: follow_cable() обязан прочитать батарею, когда кабель сменился.
        fresh();
        Host::gauge_ok = false; Host::sensors_present = true;     // плата v2: делитель и STDBY#
        I2CManager::getInstance().init();
        Host::wall = at_local(12, 0);
        Host::vcell = 4.050f;                     // у верха кривой 804050: «почти полная»
        Host::usb_in = false; Host::stdby_low = false;
        rtc_bat_cable = 0xFF;                     // мусор после нового образа: значит «прочитать»
        s_sensors_ok = -1;
        follow_cable();
        const float before = rtc_soc;
        ok(before > 80.0f && before < 100.0f, "на батарее — измеренный процент, не 100");

        const int bursts = Host::adc_bursts;
        Host::wall += 30;
        follow_cable();
        eq_int(Host::adc_bursts, bursts, "кабель не менялся — лишнего чтения нет");

        Host::usb_in = true; Host::stdby_low = true; Host::wall += 30;    // воткнут, зарядник: готово
        follow_cable();
        ok(fabsf(rtc_soc - 100.0f) < 0.01f, "кабель воткнут, зарядник закончил — 100 %");

        Host::usb_in = false; Host::stdby_low = false; Host::wall += 60;   // вынут через минуту
        follow_cable();
        ok(fabsf(rtc_soc - 100.0f) < 0.01f,
           "вынут через минуту — на стекле по-прежнему 100, а не измеренные 96");
        eq_int(s_sensors_ok, -1, "самотест: на пробуждении без замера датчиков не спрашивали");

        // И держится: через три часа на батарее — всё ещё 100 (четырёхчасовое удержание).
        Host::wall += 3 * 3600;
        float co2 = 0, t = 0, h = 0, pres = 0, iaq = 0, soc = rtc_soc; uint8_t acc = 0;
        read_sensors(co2, t, h, pres, iaq, acc, soc, /*with_co2=*/false, /*with_gas=*/false);
        ok(fabsf(soc - 100.0f) < 0.01f, "через три часа на батарее — всё ещё 100");
    }

    area("батарея: измерение свободно, удержание — слоем выше");
    {
        // ИЗМЕРЕНИЕ идёт за ячейкой в обе стороны. До 2026-10-13 здесь стояло удержание «не выше
        // наименьшего с тех пор, как вынули кабель» — правило владельца, но применённое к числу,
        // по которому считается расход: ряд, которому запрещено подниматься, на плато стоит сутками,
        // а прямая через постоянную плоская. Правило живёт в battery_display.cpp (ниже, «показанный
        // процент»), где оно и было написано 2026-10-05.
        fresh();
        const float p1 = BatterySource::percent(3.800f, 1000.0, false, false);
        const float p2 = BatterySource::percent(3.820f, 1300.0, false, false);
        ok(p2 > p1, "измерение идёт за ячейкой вверх — здесь его больше нечему держать");
        // Вниз — со скоростью среднего (полчаса), поэтому здесь почти час: за пять минут среднее
        // проходит лишь 15 % пути.
        const float p3 = BatterySource::percent(3.790f, 4600.0, false, false);
        ok(p3 < p2, "и вниз");
    }
    {
        // А владельцу подъём показывается ОГРАНИЧЕННО (2026-10-19): то же движение через слой
        // отображения, но со скоростью владельца, а не одним шагом. До этого подъём запрещался
        // вовсе, и это была защёлка: одно нагруженное чтение становилось потолком навсегда.
        fresh();
        BatteryDisplay::State st; BatteryDisplay::reset(st);
        const float s1 = BatteryDisplay::step(st, 60.0f, false, false, 0.0f, 1000.0, 1.0f, false).shown;
        const float s2 = BatteryDisplay::step(st, 62.0f, false, false, 0.0f, 1300.0, 1.0f, false).shown;
        ok(s2 > s1, "на стекле процент за измерением поднимается");
        ok(s2 - s1 <= BatteryDisplay::CATCHUP_PCT_H * 300.0f / 3600.0f + 1e-5f,
           "но не быстрее темпа владельца за эти 5 минут, а не на все два пункта");
        ok(s2 < 61.0f, "то есть измерения одним шагом он не догоняет");
        ok(BatteryDisplay::step(st, 58.0f, false, false, 0.0f, 4600.0, 1.0f, false).shown < s1,
           "а вниз идёт");
    }
    {
        // Кабель не усредняется: на нём среднее обходится, поэтому первое чтение после него идёт от
        // напряжения кабеля, а не тянется из прошлой батареи.
        fresh();
        BatterySource::percent(3.800f, 1000.0, false, false);
        BatterySource::percent(3.900f, 1060.0, true, false);           // кабель вставили
        const float after = BatterySource::percent(3.880f, 1120.0, false, false);
        ok(after > BatterySource::socFromVoltage(3.800f) + 5.0f,
           "после кабеля процент следует за ячейкой, а не за прошлым средним");

        // Тот же путь через «зарядник сказал готово»: там 100 возвращается раньше, чем что-либо
        // ещё трогает среднее.
        fresh();
        BatterySource::percent(3.800f, 1000.0, false, false);
        BatterySource::percent(4.180f, 1060.0, true, /*charge_done=*/true);
        ok(BatterySource::percent(4.170f, 1120.0, false, false) > 90.0f,
           "и после полной зарядки — а не 47 % с прошлой батареи");
    }
    {
        // Калибровка начинает среднее заново: прежние значения были в прежних единицах, и поправка
        // вверх иначе показалась бы только через полчаса.
        fresh(); auto bus = v2_bus(); Host::vcell = 3.85f;
        BatterySource::percent(3.80f, 1000.0, false, false);
        float f = 0.0f, r = 0.0f;
        BatterySource::calibrate(bus, 3.90f, f, r);
        ok(BatterySource::percent(3.90f, 1300.0, false, false) > BatterySource::socFromVoltage(3.85f),
           "после калибровки процент сразу исправленный, без разгона среднего");
    }
    {
        // Заряд, который зарядник назвал законченным, — 100 %. Это факт из железа, а напряжение —
        // оценка: экран и раньше рисовал 100, а Telegram, консоль и MQTT брали вольты.
        fresh();
        // Напряжение берётся ниже верха ЛЮБОЙ разумной таблицы: измеренная ставит 100 % уже на
        // 4,058 В, так что проверка на 4,15 В перестала бы что-либо доказывать.
        ok(BatterySource::percent(3.950f, 1000.0, true, /*charge_done=*/true) == 100.0f,
           "STDBY «заряжено» — ровно 100, даже при 3,95 В");
        ok(BatterySource::percent(3.950f, 1060.0, true, false) < 99.0f,
           "а без него те же 3,95 В — оценка по кривой, не 100 (иначе проверка ничего не доказывает)");
    }
    {
        // И через весь путь: потолок заряда ограничивает ОЦЕНКУ, но не факт. Якорь ставится низким
        // настоящим чтением на батарее, потом кабель и зарядник, сказавший «готово».
        fresh(); auto bus = v2_bus();
        BatteryInfo bi;
        Host::vcell = 3.60f;
        BatteryMonitor::getInstance().update(bus, 1000.0, bi, false);   // якорь ~8 %
        Host::vcell = 4.15f; Host::stdby_low = true;
        BatteryMonitor::getInstance().update(bus, 1060.0, bi, true);    // минута на кабеле
        ok(bi.soc == 100.0f, "зарядник сказал «готово» — 100 % во всех выходах, потолок не режет");
        eq_int(bi.charge_state, BAT_IDLE, "и состояние — не «заряжается»");
        Host::stdby_low = false;
        BatteryMonitor::getInstance().update(bus, 1120.0, bi, true);
        ok(bi.soc < 50.0f, "а без «готово» тот же кабель через две минуты — под потолком, как раньше");
    }
    {
        // Плата v1 с 2026-10-08: процент — по измеренной кривой ЕЁ ячейки (103450), а не модель
        // газомера. Модель ни под какую ячейку не настраивалась и на плато этой стояла: в поле 1 % за
        // неделю при ~5 % по вольтам (2026-10-01..08) — и с ней стояли все оценки расхода.
        fresh(); auto bus = (I2CManager::getInstance().init(), I2CManager::getInstance().getBusHandle());
        BatteryInfo bi;
        Host::vcell = 4.043f;
        Host::soc = 50.0f;                    // модель может говорить что угодно — её не спрашивают
        BatteryMonitor::getInstance().update(bus, 1000.0, bi, false);
        // Сверяется с тем напряжением, которое прибор прочитал: регистр VCELL квантует шагом
        // 78,125 мкВ, и 4,043 В приходят как 4,04297 — на плато это 0,02 %.
        near(bi.soc_raw, BatterySource::socFromVoltage(bi.voltage, BatterySource::Cell103450), 0.001,
             "на плате v1 измеренный процент — по таблице её ячейки");
        near(bi.soc_raw, 82.857, 0.05, "4,043 В на плато 103450 — 82,9 %, а не 50 от модели газомера");
        // То же разделение, что у делителя: ИЗМЕРЕНИЕ идёт за ячейкой вверх (по нему считают расход),
        // а ПОКАЗАННОЕ владельцу — нет.
        const float shown_before = bi.soc;
        Host::vcell = 4.047f; Host::soc = 90.0f;
        BatteryMonitor::getInstance().update(bus, 1300.0, bi, false);
        ok(bi.soc_raw > 82.858f, "измерение на v1 идёт за ячейкой вверх");
        ok(bi.soc > shown_before && bi.soc - shown_before < 0.05f,
           "а на стекле — только на темп владельца за эти 5 минут, не скачком");
        Host::vcell = 4.030f;
        BatteryMonitor::getInstance().update(bus, 4900.0, bi, false);
        ok(bi.soc_raw < 82.0f, "а вниз идёт за напряжением");
        // «Готово» на v1 выводится из газомера так же, как раньше: кабель, 4,10 В и скорость ниже
        // половины процента в час — и тогда это 100 % во всех выходах, как у v2 по STDBY.
        Host::vcell = 4.18f; Host::crate = 0.1f;
        BatteryMonitor::getInstance().update(bus, 5000.0, bi, true);
        ok(bi.soc_raw == 100.0f && bi.soc == 100.0f, "зарядник закончил — 100 %, и на стекле тоже");
        Host::crate = 30.0f;
        BatteryMonitor::getInstance().update(bus, 5060.0, bi, true);
        eq_int(bi.charge_state, BAT_CHARGING, "а пока газомер видит заряд — «заряжается»");
        ok(bi.soc < 100.0f, "и на стекле под потолком заряда, а не сто по напряжению зарядника");
    }

    // --------------------------------------------------------------------------------------------
    area("стенд разряда: журнал во флеше");
    {
        // Журнал пишет прошивка (curve_log.cpp), читает скрипт на компьютере (tools/curve_fit.py).
        // Здесь — сторона прошивки; сторона скрипта — t_curve.py, по образу, который пишется ниже
        // ЭТИМ ЖЕ кодом.
        fresh();
        ok(CurveLog::capacity() == 64 * 1024 / 32, "журнал занимает раздел дампа целиком: 2048 записей");
        CurveLog::erase_all();
        eq_int(CurveLog::next_free(), 0, "после стирания пишется с начала");
        CurveLog::Rec a = {};
        a.kind = CurveLog::KindSample; a.t = 1234; a.load_s = 900; a.v_rest = 3.9123f; a.gain = 1.018f; a.seq = 7;
        ok(CurveLog::append(a), "запись принята");
        CurveLog::Rec b = {};
        ok(CurveLog::read(0, b) && CurveLog::valid(b) && b.t == 1234 && b.load_s == 900
               && b.v_rest == 3.9123f && b.seq == 7, "и читается обратно та же");
        b.v_rest = 3.9124f;
        ok(!CurveLog::valid(b), "один изменённый байт — контрольная сумма не сходится");

        // Разорванная запись (сброс посреди записи во флеш): ни верная, ни стёртая. Писать поверх
        // неё нельзя — испортится следующая, — поэтому дописывается в первую СТЁРТУЮ ячейку.
        const esp_partition_t *pt = esp_partition_find_first(ESP_PARTITION_TYPE_DATA,
                                                             ESP_PARTITION_SUBTYPE_DATA_COREDUMP, nullptr);
        const uint8_t torn[12] = {0xB1, 0xC7, 2, 0, 1, 2, 3, 4, 5, 6, 7, 8};
        esp_partition_write(pt, 1 * 32, torn, sizeof(torn));
        eq_int(CurveLog::next_free(), 2, "разорванная запись пропускается, а не затирается");
        CurveLog::Rec c = {}; c.kind = CurveLog::KindEnd; c.seq = 8;
        CurveLog::append(c);
        CurveLog::Rec d = {};
        ok(CurveLog::read(2, d) && CurveLog::valid(d) && d.seq == 8, "следующая легла после неё");
    }
    {
        // Синтетический прогон для t_curve.py. Кривая «правды» — та же формула, что в t_curve.py:
        // V(s) = 3,30 + 0,35·(1 − e^(−s/6)) + 0,53·s/100 + 0,02·sin(π·s/100). Хвост крутой, как у
        // настоящей ячейки (около 60 мВ на процент у порога), но с конечным наклоном; монотонна.
        auto truth = [](double s) {
            return s >= 0 ? 3.30 + 0.35 * (1.0 - exp(-s / 6.0)) + 0.53 * s / 100.0 + 0.02 * sin(M_PI * s / 100.0)
                          : 3.30 + 0.0636 * s;        // ниже порога — с тем же наклоном дальше вниз
        };
        auto dump = [&](const char *name) {
            const esp_partition_t *pt = esp_partition_find_first(ESP_PARTITION_TYPE_DATA,
                                                                 ESP_PARTITION_SUBTYPE_DATA_COREDUMP, nullptr);
            std::vector<uint8_t> img(pt->size);
            esp_partition_read(pt, 0, img.data(), img.size());
            std::string path = std::string(__FILE__);
            path = path.substr(0, path.rfind('/')) + "/.cycle-obj/" + name;
            FILE *f = fopen(path.c_str(), "wb");
            if (f) { fwrite(img.data(), 1, img.size(), f); fclose(f); }
            return f != nullptr;
        };
        auto run = [&](bool void_it) {
            CurveLog::erase_all();
            uint16_t seq = 0;
            CurveLog::Rec h = {}; h.kind = CurveLog::KindHeader; h.t = 1790000000u; h.gain = 1.0f;
            h.detail = 1; h.seq = ++seq; CurveLog::append(h);   // формат v1: один разряд
            const double rr = 0.0125, Q_END = 100000.0;
            uint32_t t = 300, load_s = 0;               // первый отдых — сразу после зарядника
            for (int k = 0;; k++) {
                const double q = load_s + rr * (t - load_s);
                const double v = truth(100.0 * (1.0 - q / Q_END));
                CurveLog::Rec r = {}; r.kind = CurveLog::KindSample; r.t = t; r.load_s = load_s;
                r.v_rest = (float)v; r.v_load = k ? (float)(v - 0.015) : 0.0f; r.gain = 1.0f;
                r.seq = ++seq; r.spread = 3; CurveLog::append(r);
                if (k == 10) {                                   // разорванная запись посреди прогона
                    const esp_partition_t *pt = esp_partition_find_first(
                        ESP_PARTITION_TYPE_DATA, ESP_PARTITION_SUBTYPE_DATA_COREDUMP, nullptr);
                    const uint8_t torn[9] = {0xB1, 0xC7, 2, 0, 9, 9, 9, 9, 9};
                    esp_partition_write(pt, (size_t)CurveLog::next_free() * 32, torn, sizeof(torn));
                }
                if (void_it && k == 40) {
                    CurveLog::Rec c = {}; c.kind = CurveLog::KindCharger; c.seq = ++seq; CurveLog::append(c);
                }
                if (v <= 3.25) {
                    CurveLog::Rec e = {}; e.kind = CurveLog::KindEnd; e.t = t; e.load_s = load_s;
                    e.v_rest = (float)v; e.gain = 1.0f; e.seq = ++seq; CurveLog::append(e);
                    break;
                }
                const uint32_t load = v < 3.55 ? 300 : 900;   // как стенд: на хвосте нагрузка короче
                load_s += load; t += load + 300;
            }
        };
        fresh();
        run(false);
        ok(dump("curve_run.bin"), "образ прогона записан для t_curve.py");
        run(true);
        ok(dump("curve_void.bin"), "и образ испорченного кабелем прогона");
    }

    area("стенд АКБ: полный тест — журнал, разбор, решения стенда");
    {
        // Журнал v2 — целый тест: C0 → D1 → C1 → D2 → C2. Его пишет прошивка (curve_log.cpp), разбирает
        // она же (curve_summary.cpp: что рисовать и что делать после каждой загрузки), и тот же образ
        // читает скрипт на компьютере (t_curve.py). Здесь — сторона прошивки: образ пишется ЭТИМ кодом,
        // и на каждом шаге проверяется, что решил бы стенд, если бы в этот момент перезагрузился.
        using CurveSummary::Next;
        static CurveSummary::State st;
        auto truth = [](double s) {
            return s >= 0 ? 3.30 + 0.35 * (1.0 - exp(-s / 6.0)) + 0.53 * s / 100.0 + 0.02 * sin(M_PI * s / 100.0)
                          : 3.30 + 0.0636 * s;
        };
        auto dump = [&](const char *name) {
            const esp_partition_t *pt = esp_partition_find_first(ESP_PARTITION_TYPE_DATA,
                                                                 ESP_PARTITION_SUBTYPE_DATA_COREDUMP, nullptr);
            std::vector<uint8_t> img(pt->size);
            esp_partition_read(pt, 0, img.data(), img.size());
            std::string path = std::string(__FILE__);
            path = path.substr(0, path.rfind('/')) + "/.cycle-obj/" + name;
            FILE *f = fopen(path.c_str(), "wb");
            if (f) { fwrite(img.data(), 1, img.size(), f); fclose(f); }
            return f != nullptr;
        };
        struct Cell {                  // what a synthetic cell is, the truth the readers must recover
            double q_s;                // charge axis to 0 %: load seconds plus the rests' share
            float sag, pulse, step;    // V: after 15 min of load, 10 s into it, 10 s on the charger
            uint32_t cc_s, cv_s;       // the charge from the cutoff
            double i_load;             // A: the discharge load — what the R7 readings must recover
        };
        // The numbers the readers must find, per image; t_curve.py gets them as JSON.
        struct Truth { double d_q0_h[3]; uint32_t c_done[3], c_cv[3]; float c_iest[3]; float d_pulse_last[3]; float c_step[3];
                       double d_qend_h[3], c_prog_true[3]; } tr = {};
        uint16_t seq = 0;
        uint32_t now = 1790000000u;
        const float G = 0.99f;         // the divider gain: raw readings are stored, the gain beside them
        bool check = true;
        double cell_load_ma = 0;
        auto put = [&](CurveLog::Rec r) {
            r.seq = ++seq; r.gain = G;
            CurveLog::append(r);
            st.feed(r);
        };
        auto expect = [&](Next n, const char *what) {
            if (check) ok(CurveSummary::next(st) == n, what);
        };
        auto mk = [](CurveLog::Kind k) { CurveLog::Rec r; memset(&r, 0, sizeof r); r.kind = k; return r; };
        float last_rest = 0;           // raw
        // A charge from v_before (raw, 0 = unknown) to the end; then `relax` minutes on the idle charger.
        auto charge = [&](uint8_t cyc, bool re, const Cell &c, float v_before_g, uint32_t cc_s, uint32_t cv_s,
                          int relax_min, bool idle_first) {
            const uint32_t t0 = now;
            CurveLog::Rec s = mk(CurveLog::KindChargeStart);
            s.t = t0; s.spread = cyc; s.flags = CurveLog::FlagUsb | (re ? CurveLog::FlagRecharge : 0);
            s.v_rest = v_before_g > 0 ? v_before_g / G : 0;
            // Near full, the jump at plug-in would cross TP4056's float voltage: then there is no
            // constant-current phase at all, the charger holds 4.20 V from the first second.
            const float v0 = fminf((v_before_g > 0 ? v_before_g : 3.95f) + c.step, 4.20f);
            s.v_load = (v0 - 0.002f) / G; s.detail = CurveLog::temp_code(23.0f);
            put(s);
            expect(Next::Charging, "кабель вставлен — стенд заряжает");
            if (idle_first) {          // зарядник сразу сказал «готово», ничего не зарядив
                CurveLog::Rec x = mk(CurveLog::KindChargeSample);
                x.t = 10; x.load_s = 3; x.v_rest = v0 / G; x.flags = CurveLog::FlagUsb | CurveLog::FlagStdby;
                put(x);
                CurveLog::Rec u = mk(CurveLog::KindUnplug); u.t = 40; u.load_s = 3; u.detail = 1;
                put(u);
                expect(Next::RunDown, "«готово» без заряда и кабель вынут — стенд разряжает ячейку ниже 4,00 В");
                now += 4 * 3600;
                return;
            }
            const uint32_t total = cc_s + cv_s;
            std::vector<uint32_t> ts = {10, 60};
            for (uint32_t t = 180; t < total + relax_min * 60 + 121; t += 120) ts.push_back(t);
            // The charge current, for a charge that refills a complete discharge: TP4056 held back
            // by heat at first (90 % of its current, rising to 100 % by constant voltage), then the
            // constant-voltage fall down to its termination current at the end. Scaled so that it
            // puts back exactly what the discharge took at the cell's load current — so the readings
            // below, integrated, must give the load current back.
            std::vector<std::pair<uint32_t, float>> prog;
            if (!re && cyc >= 1 && tr.d_qend_h[cyc] > 0) {
                auto cur = [&](double t, double icc) {
                    if (t < cc_s) return icc * (0.9 + 0.1 * t / cc_s);
                    return icc * exp(-log(icc / CurveSummary::CHARGE_TERM_A) / cv_s * (t - cc_s));
                };
                auto integral = [&](double icc) { double a = 0; for (uint32_t t = 0; t < total; t++) a += cur(t + 0.5, icc); return a; };
                const double want = c.i_load * tr.d_qend_h[cyc] * 3600.0;      // A*s
                double lo = 0.2, hi = 3.0;
                for (int i = 0; i < 60; i++) { const double m = 0.5 * (lo + hi); (integral(m) < want ? lo : hi) = m; }
                const double icc = 0.5 * (lo + hi);
                tr.c_prog_true[cyc] = integral(icc) / 3.6;
                // Readings when the bench asks (2, 10, 20, 30 min, then every 15), each 45 s late.
                std::vector<uint32_t> slots = {120, 600, 1200, 1800};
                for (uint32_t t = 2700; t < total; t += 900) slots.push_back(t);
                for (uint32_t sl : slots)
                    if (sl + 45 < total) prog.push_back({sl + 45, roundf((float)cur(sl + 45, icc) * 1000.0f) / 1000.0f});
            }
            size_t pi = 0;
            float top = 0; bool ended = false; uint32_t tcv = 0; float v10 = 0;
            for (uint32_t t : ts) {
                for (; pi < prog.size() && prog[pi].first < t; pi++) {
                    CurveLog::Rec x = mk(CurveLog::KindProg);
                    x.t = prog[pi].first; x.load_s = prog[pi].first; x.v_load = prog[pi].second;
                    x.spread = (uint8_t)(pi + 1); x.flags = CurveLog::FlagUsb;
                    put(x);
                }
                if (!ended && t >= total) {
                    top = fmaxf(top, 4.201f);
                    CurveLog::Rec e = mk(CurveLog::KindChargeEnd);
                    e.t = total; e.load_s = total; e.v_rest = 4.200f / G; e.v_load = 4.201f / G;
                    e.flags = CurveLog::FlagUsb | CurveLog::FlagStdby; e.detail = CurveLog::temp_code(26.0f);
                    put(e);
                    ended = true;
                    if (cyc == 2 && !re) {
                        expect(Next::Complete, "последний заряд кончился — тест окончен");
                        put(mk(CurveLog::KindTestDone));
                    } else expect(Next::ChargedFull, "зарядник сказал «готово» — следующий разряд по выдернутому кабелю");
                }
                float v;
                if (t < cc_s) v = v0 + (4.20f - v0) * sqrtf((float)t / cc_s);
                else if (t < total) v = 4.20f;
                else v = 4.06f + 0.14f * expf(-(float)(t - total) / 480.0f);
                if (!ended) {
                    if (t >= 10 && v10 == 0) v10 = v;
                    top = fmaxf(top, v);
                }
                CurveLog::Rec x = mk(CurveLog::KindChargeSample);
                x.t = t; x.load_s = t < total ? t : total; x.v_rest = v / G;
                x.flags = CurveLog::FlagUsb | (t >= total ? CurveLog::FlagStdby : 0);
                x.detail = CurveLog::temp_code(t < total ? 24.0f + 3.0f * (float)t / total : 24.5f);
                put(x);
            }
            // The truth for the end of constant current: the first sample within 10 mV of the top.
            float top_all = 4.201f;
            if (v0 - 0.002f >= top_all - 0.010f) tcv = 0;       // the first reading, at plug-in
            else for (uint32_t t : ts) {
                if (t >= total) break;
                const float v = t < cc_s ? v0 + (4.20f - v0) * sqrtf((float)t / cc_s) : 4.20f;
                if (v >= top_all - 0.010f) { tcv = t; break; }
            }
            if (!re) { tr.c_done[cyc] = total; tr.c_cv[cyc] = tcv; tr.c_step[cyc] = v_before_g > 0 ? v10 - v_before_g : 0; }
            now = t0 + total + relax_min * 60 + 600;
        };
        // A discharge of `c`; voided by the cable at sample `void_at` (-1 = never); a reset at `reset_at`.
        auto discharge = [&](uint8_t cyc, const Cell &c, int void_at, int reset_at, int torn_at) {
            const uint32_t t0 = now;
            CurveLog::Rec h = mk(CurveLog::KindHeader);
            h.t = t0; h.spread = cyc; h.detail = CurveLog::VERSION;
            put(h);
            expect(Next::Discharging, "кабель выдернут — идёт разряд");
            const double rr = 0.0125;
            uint32_t t = 300, load_s = 0;
            float pending = 0, pulse_last = 0;
            for (int k = 0;; k++) {
                const double q = load_s + rr * (t - load_s);
                const double v = truth(100.0 * (1.0 - q / c.q_s));
                CurveLog::Rec r = mk(CurveLog::KindSample);
                r.t = t; r.load_s = load_s; r.v_rest = (float)(v / G); r.v_load = pending;
                r.spread = 3; r.detail = CurveLog::temp_code(24.0f + 0.5f * sinf(k / 7.0f));
                put(r);
                last_rest = r.v_rest;
                if (k == torn_at) {
                    const esp_partition_t *pt = esp_partition_find_first(
                        ESP_PARTITION_TYPE_DATA, ESP_PARTITION_SUBTYPE_DATA_COREDUMP, nullptr);
                    const uint8_t torn[11] = {0xB1, 0xC7, 2, 0, 9, 9, 9, 9, 9, 9, 9};
                    esp_partition_write(pt, (size_t)CurveLog::next_free() * 32, torn, sizeof(torn));
                }
                if (k == reset_at) {
                    CurveLog::Rec x = mk(CurveLog::KindReset); x.t = t + 2; x.load_s = load_s; x.detail = 9;
                    put(x);
                    expect(Next::Discharging, "сброс посреди разряда — разряд продолжается");
                }
                if (k == void_at) {
                    CurveLog::Rec x = mk(CurveLog::KindCharger); x.t = t + 30; x.load_s = load_s;
                    put(x);
                    expect(Next::DischargeVoid, "кабель посреди разряда — разряд испорчен, дальше дозаряд");
                    now = t0 + t + 60;
                    return;
                }
                if (v <= 3.25) {
                    CurveLog::Rec e = mk(CurveLog::KindEnd); e.t = t; e.load_s = load_s; e.v_rest = r.v_rest;
                    put(e);
                    tr.d_qend_h[cyc] = q / 3600.0;
                    expect(Next::DischargeDone, "порог — разряд окончен, ждём кабель");
                    tr.d_q0_h[cyc] = c.q_s / 3600.0;
                    tr.d_pulse_last[cyc] = pulse_last;
                    now = t0 + t + 1800;
                    return;
                }
                const uint32_t load = v < 3.55 ? 300 : 900;
                CurveLog::Rec p = mk(CurveLog::KindPulse);
                p.t = t + 25; p.load_s = load_s + 10; p.v_rest = (float)(v / G); p.v_load = (float)((v - c.pulse) / G);
                p.detail = r.detail;
                put(p);
                pulse_last = c.pulse * 1000.0f;
                pending = (float)((v - (k < 3 ? c.sag * 0.8 : c.sag)) / G);
                load_s += load; t += load + 300;
            }
        };
        auto whole_test = [&](const Cell &c, bool trouble) {
            CurveLog::erase_all();
            st.reset(); seq = 0; tr = {}; now = 1790000000u;
            expect(Next::Empty, "пустой журнал — ждём кабель, чтобы начать тест");
            CurveLog::Rec t = mk(CurveLog::KindTest); t.t = now; t.detail = CurveLog::VERSION;
            put(t);
            expect(Next::Begin, "запись теста без отрезка (сброс сразу после неё) — начать C0");
            if (trouble) charge(0, false, c, 0, 0, 0, 0, true);
            charge(0, false, c, trouble ? 3.995f : 0, 600, 1500, 20, false);
            if (trouble) {
                discharge(1, c, 20, -1, -1);
                charge(0, true, c, last_rest * G, 900, 1500, 0, false);
            }
            discharge(1, c, -1, -1, trouble ? 10 : -1);
            const float d1_last = last_rest * G;
            charge(1, false, c, d1_last, c.cc_s, c.cv_s, 30, false);
            tr.c_iest[1] = st.c[1].i_est_ma;
            discharge(2, c, -1, trouble ? 30 : -1, -1);
            charge(2, false, c, last_rest * G, c.cc_s + 60, c.cv_s, 40, false);
            tr.c_iest[2] = st.c[2].i_est_ma;
        };
        auto write_truth = [&](const char *name) {
            std::string path = std::string(__FILE__);
            path = path.substr(0, path.rfind('/')) + "/.cycle-obj/" + name;
            FILE *f = fopen(path.c_str(), "w");
            if (!f) return false;
            fprintf(f, "{\"d_q0_h\": [0, %.6f, %.6f], \"c_done\": [%u, %u, %u], \"c_cv\": [%u, %u, %u],"
                       " \"fw\": {\"d_q0_h\": [0, %.6f, %.6f], \"d_mah\": [0, %.3f, %.3f], \"d_wh\": [0, %.4f, %.4f],"
                       " \"c_done\": [%u, %u, %u], \"c_cv\": [%u, %u, %u], \"c_iest\": [0, %.3f, %.3f],"
                       " \"d_pulse\": [0, %.3f, %.3f], \"c_relaxed\": [%.4f, %.4f, %.4f],"
                       " \"c_prog\": [%.3f, %.3f, %.3f], \"load_meas\": %.4f},"
                       " \"c_prog_true\": [0, %.3f, %.3f], \"load_true\": %.3f}\n",
                    tr.d_q0_h[1], tr.d_q0_h[2], tr.c_done[0], tr.c_done[1], tr.c_done[2], tr.c_cv[0], tr.c_cv[1], tr.c_cv[2],
                    st.d[1].q0_h, st.d[2].q0_h, st.d[1].mah(), st.d[2].mah(), st.d[1].wh(), st.d[2].wh(),
                    st.c[0].t_done, st.c[1].t_done, st.c[2].t_done, st.c[0].t_cv, st.c[1].t_cv, st.c[2].t_cv,
                    st.c[1].i_est_ma, st.c[2].i_est_ma, st.d[1].pulse_mv, st.d[2].pulse_mv,
                    st.c[0].v_relaxed, st.c[1].v_relaxed, st.c[2].v_relaxed,
                    st.c[0].prog_mah, st.c[1].prog_mah, st.c[2].prog_mah, st.load_ma_measured(),
                    tr.c_prog_true[1], tr.c_prog_true[2], cell_load_ma);
            fclose(f);
            return true;
        };

        fresh();
        const Cell A = {90000.0, 0.057f, 0.041f, 0.30f, 6000, 3600, 0.0834};
        cell_load_ma = A.i_load * 1000.0;
        whole_test(A, true);           // с бедами: зарядник «полный» без заряда, кабель посреди D1, сброс в D2, разорванная запись
        ok(st.complete && CurveSummary::next(st) == Next::Complete, "тест с бедами дошёл до конца");
        ok(fabs(st.d[1].q0_h - tr.d_q0_h[1]) / tr.d_q0_h[1] < 0.001 && fabs(st.d[2].q0_h - tr.d_q0_h[2]) / tr.d_q0_h[2] < 0.001,
           "часы под нагрузкой до порога найдены в обоих разрядах (ошибка < 0,1 %)");
        ok(st.d[1].samples > 90 && st.d[1].pulses == st.d[1].samples - 1,
           "у D1 берётся ПОВТОРНЫЙ разряд, испорченный кабелем отброшен; импульс на каждой нагрузке");
        ok(st.d[2].resets == 1, "сброс в D2 записан и учтён");
        ok(st.c[0].done && !st.c[0].recharge && st.re.present && st.re.recharge && st.re.done,
           "C0 — настоящий заряд после «пустого готово»; дозаряд после испорченного D1 — отдельно, не в таблице");
        eq_int((int)st.c[1].t_done, (int)tr.c_done[1], "время заряда C1 — до STDBY");
        eq_int((int)st.c[1].t_cv, (int)tr.c_cv[1], "конец постоянного тока C1 — первая точка в 10 мВ от вершины");
        eq_int((int)st.c[2].t_cv, (int)tr.c_cv[2], "и у C2");
        {
            // Ток в начале заряда — из двух скачков: 10 с нагрузки в конце разряда и 10 с на заряднике.
            // The step at 10 s is the jump at plug-in plus ten seconds of the climb; the pulse, 41 mV.
            const float want = CurveSummary::LOAD_MA * tr.c_step[1] / A.pulse;
            char m[240];
            snprintf(m, sizeof m, "ток заряда из двух скачков: %.0f мА (ожидалось около %.0f)", st.c[1].i_est_ma, want);
            ok(fabsf(st.c[1].i_est_ma - want) / want < 0.05f, m);
            ok(st.c[0].i_est_ma == 0 && st.re.i_est_ma == 0,
               "у C0 и у дозаряда тока нет: перед ними не было законченного разряда");
        }
        {
            char m[240];
            snprintf(m, sizeof m, "после конца заряда — напряжение на простаивающем заряднике: %.3f В через %u мин",
                     st.c[1].v_relaxed, (unsigned)(st.c[1].relaxed_s / 60));
            ok(st.c[1].v_relaxed > 4.05f && st.c[1].v_relaxed < 4.07f && st.c[1].relaxed_s >= 25 * 60, m);
        }
        ok(fabsf(st.d[1].mah() - (float)(tr.d_q0_h[1] * CurveSummary::LOAD_MA)) < 3.0f,
           "мА·ч = часы до порога × принятый ток");
        {
            // Ток заряда, введённый с R7: интеграл замеров против правды, и из него — настоящий ток разряда.
            char m[240];
            snprintf(m, sizeof m, "C1: %d замеров R7, интеграл %.0f мА·ч против правды %.0f",
                     st.c[1].prog_n, st.c[1].prog_mah, tr.c_prog_true[1]);
            ok(st.c[1].prog_covers() && fabs(st.c[1].prog_mah - tr.c_prog_true[1]) / tr.c_prog_true[1] < 0.02, m);
            snprintf(m, sizeof m, "ток разряда, измеренный через заряд: %.2f мА против правды %.2f",
                     st.load_ma_measured(), A.i_load * 1000.0);
            ok(fabs(st.load_ma_measured() - A.i_load * 1000.0) / (A.i_load * 1000.0) < 0.02, m);
            ok(fabsf(st.load_ma() - st.load_ma_measured()) < 1e-6 && st.load_ma_measured() != CurveSummary::LOAD_MA,
               "и он заменяет принятые 82 мА везде, где считаются мА·ч");
            ok(st.c[0].prog_n == 0 && !st.c[0].prog_covers() && st.re.prog_n == 0,
               "у C0 и у дозаряда замеров нет — ток из них не выводится");
            // Когда стенд просит замер.
            CurveSummary::Charge q; q = CurveSummary::Charge();
            eq_int((int)CurveSummary::prog_next_due(q), 120, "первый замер — через 2 минуты");
            q.prog[q.prog_n++] = {130, 0.9f};
            eq_int((int)CurveSummary::prog_next_due(q), 600, "после замера на 2-й минуте — на 10-й");
            q.prog[q.prog_n++] = {700, 0.9f};
            eq_int((int)CurveSummary::prog_next_due(q), 1200, "дальше на 20-й");
            q.prog[q.prog_n++] = {1900, 0.9f};
            eq_int((int)CurveSummary::prog_next_due(q), 2700, "после 30-й — через 15 минут");
            q.prog[q.prog_n++] = {2650, 0.6f};
            eq_int((int)CurveSummary::prog_next_due(q), 3600, "и не раньше чем через 5 минут после последнего, где бы он ни был");
        }
        // The screen draws every state of the test without tripping over its own numbers.
        {
            EPaper e; e.init();
            CurveScreen::View v; v.gain = G; v.calibrated = true; v.now_abs = now;
            for (Next n : {Next::Empty, Next::Charging, Next::Discharging, Next::DischargeVoid, Next::Complete}) {
                v.next = n; CurveScreen::draw(e, st, v);
            }
            CurveSummary::State empty; empty.reset();
            CurveScreen::draw(e, empty, v);
            ok(true, "экран рисует все состояния, и пустое тоже");
        }
        ok(dump("battery_test_a.bin") && write_truth("battery_test_a.json"), "образ теста A записан для t_curve.py");

        // Второй элемент: меньше ёмкость, больше сопротивление, дольше заряд. Сравнение должно это найти.
        check = false;
        const Cell B = {81000.0, 0.071f, 0.055f, 0.36f, 5400, 3000, 0.0834};
        cell_load_ma = B.i_load * 1000.0;
        whole_test(B, false);
        ok(st.complete && fabs(st.d[2].q0_h / st.d[1].q0_h - 1.0) < 0.001, "тест B без бед — до конца");
        ok(dump("battery_test_b.bin") && write_truth("battery_test_b.json"), "образ теста B записан для t_curve.py");

        // Старый журнал (v1, без записи теста) — стенд его не трогает, пока не попросят кнопкой.
        CurveLog::erase_all(); st.reset();
        CurveLog::Rec h = {}; h.kind = CurveLog::KindHeader; h.t = 1; h.gain = 1; h.seq = 1; CurveLog::append(h);
        h.kind = CurveLog::KindSample; h.seq = 2; h.v_rest = 4.0f; CurveLog::append(h);
        {
            CurveLog::Rec r; const int n = CurveLog::next_free();
            for (int i = 0; i < n; i++) if (CurveLog::read(i, r) && CurveLog::valid(r)) st.feed(r);
        }
        ok(CurveSummary::next(st) == Next::OldLog, "журнал прежнего стенда — «старый журнал», стирается только кнопкой");
    }

    area("погода: нажатие поднимает радио только когда источнику есть что дать");
    {
        // Порог был плоский — 15 минут, — и подменял собой то, чему не равен. Настоящий предел
        // ставит сам источник: MET не спрашивают раньше Expires его прошлого ответа, а тот идёт
        // примерно на полчаса вперёд. В промежутке нажатие поднимало радио, получало отказ той же
        // проверкой и возвращалось с теми же числами.
        const time_t T = 1759000000;
        fresh();
        rtc_last_weather = T - 5 * 60;          // погоде пять минут
        rtc_met_expires  = T + 25 * 60;         // MET ещё четверть часа не ответит
        ok(weather_is_current(T, true), "MET: до Expires в сеть не идём");

        rtc_last_weather = T - 20 * 60;         // СТАРШЕ прежних 900 с…
        rtc_met_expires  = T + 10 * 60;         // …но MET всё ещё не ответит
        ok(weather_is_current(T, true),
           "и на двадцатой минуте тоже: прежнее правило здесь поднимало радио впустую");

        rtc_met_expires = T - 1;                // Expires прошёл
        ok(!weather_is_current(T, true), "после Expires — идём, источнику есть что дать");
    }
    {
        // Ограждение то же, что в самом заборе: срок дальше шести часов этот код не писал.
        const time_t T = 1759000000;
        fresh();
        rtc_last_weather = T - 60;
        rtc_met_expires  = T + 7 * 3600;
        ok(!weather_is_current(T, true),
           "нелепо далёкий Expires не связывает прибор — как и в fetch_own_weather()");
    }
    {
        // У OWM своего Expires нет, там прежние 15 минут и остаются.
        const time_t T = 1759000000;
        fresh(); Host::set_u8("wx_src", 1); Host::set_str("owm", "ключ");
        rtc_met_expires = 0;
        rtc_last_weather = T - 5 * 60;
        ok(weather_is_current(T, true), "OWM: пять минут — свежо");
        rtc_last_weather = T - 20 * 60;
        ok(!weather_is_current(T, true), "OWM: двадцать минут — пора");
    }
    {
        // Источник выбирается ТАК ЖЕ, как в fetch_own_weather(): без ключа OWM это на самом деле
        // MET. Правило, решающее по другому источнику, чем тот, который спросят, хуже отсутствия
        // правила.
        const time_t T = 1759000000;
        fresh(); Host::set_u8("wx_src", 1);     // выбран OWM, но ключа нет
        rtc_last_weather = T - 20 * 60;         // по правилу OWM было бы «пора»
        rtc_met_expires  = T + 10 * 60;         // а спросят MET, и он молчит
        ok(weather_is_current(T, true), "OWM без ключа — это MET, и правило берёт его Expires");
    }
    {
        // Без часов и без единого успешного забора решать не по чему — идём в сеть.
        const time_t T = 1759000000;
        fresh(); rtc_met_expires = T + 25 * 60;
        rtc_last_weather = T - 60;
        ok(!weather_is_current(T, false), "без часов возраст не считается — идём");
        rtc_last_weather = 0;
        ok(!weather_is_current(T, true), "погоды не было ни разу — идём");
    }

    // ---------------------------------------------------------------------------------------------
    // Расход по истории — единственная оценка на карточке батареи (power_estimate.h). До 2026-10-03
    // три верхних числа считал второй наклон в RTC_DATA: каждая перезагрузка его обнуляла, через
    // шесть часов он заговаривал при любом сдвиге газомера, и на телефоне стояло «523 days,
    // 0.16 %/day, 3 mAh» при настоящем расходе около 13 мА·ч в сутки — под заметкой «Collecting».
    // ---------------------------------------------------------------------------------------------
    // Показанный процент (battery_display.h), решение владельца 2026-10-05: после отключения полного
    // прибора никакого скачка вниз, разрыв закрывается плавно, 0,5 пункта в час. Числа ниже посчитаны
    // от правил вручную, а не сняты с кода.
    area("батарея: показанный процент — после полного заряда");
    {
        using namespace BatteryDisplay;
        State st; reset(st);
        float k = 1.0f; bool have_k = false;
        double t = 1759000000.0;
        // Другая ячейка: успокоившись после полного заряда, она меряется в 94 %, а не в 100.
        Step r = step(st, 100.0f, true, false, 70.0f, t, k, have_k);
        near(r.shown, 70.0, 1e-4, "на кабеле показывается то, что решила логика кабеля");
        t += 3600; r = step(st, 100.0f, true, true, 100.0f, t, k, have_k);
        near(r.shown, 100.0, 1e-4, "зарядник закончил — 100");
        t += 300; r = step(st, 96.0f, false, false, 0.0f, t, k, have_k);
        near(r.shown, 100.0, 1e-4, "кабель вынут после полного заряда: 100, а не 96 — скачка нет");
        bool held = true, learned = false;
        for (int i = 0; i < 48 && !learned; i++) {            // 4 ч по 5 мин
            t += 300;
            const float m = 96.0f - 2.0f * (i + 1) / 48.0f;   // ячейка отходит после заряда: 96 -> 94
            r = step(st, m, false, false, 0.0f, t, k, have_k);
            if (r.learned) { learned = true; k = r.k; have_k = true; }
            else if (fabsf(r.shown - 100.0f) > 1e-4f) held = false;
        }
        ok(held, "пока ячейка успокаивается (4 ч), стоит 100: это отход от зарядника, а не расход");
        ok(learned, "через 4 ч полный заряд выучен");
        near(k, 100.0 / 94.0, 0.002, "масштаб = 100 / 94");
        near(r.shown, 100.0, 0.05, "и после обучения на стекле те же 100 — шва нет");
        // Месяц разряда по 2 % в сутки, замер каждые 5 мин: 94 -> 34.
        float prev = r.shown, worst_gap = 0.0f; bool mono = true;
        for (int i = 0; i < 30 * 288; i++) {
            t += 300;
            const float m = 94.0f - 2.0f * (i + 1) / 288.0f;
            r = step(st, m, false, false, 0.0f, t, k, have_k);
            if (r.shown > prev + 1e-5f) mono = false;
            prev = r.shown;
            worst_gap = fmaxf(worst_gap, fabsf(r.shown - target(m, k)));
        }
        ok(mono, "на батарее процент только падает");
        // Отставание РОВНО то, которое даёт сглаживание цели: равновесный зазор — это спад цели за
        // шаг, делённый на коэффициент фильтра. Здесь спад 2 %/сут × k = 2,128 %/сут, то есть
        // 0,0073879 за 300 с, а a = 1 − exp(−300/14400) = 0,0206180: зазор 0,3583 пункта.
        // Посчитано отдельно по SMOOTH_TAU_S, а не снято с кода. Это цена за то, что дрожание
        // измерения (в поле до 25 пунктов за запись) стекла не двигает вовсе.
        near(worst_gap, 0.3583, 0.03, "и отстаёт ровно на столько, сколько стоит сглаживание цели");
        near(r.shown, 34.0 * 100.0 / 94.0 + 0.3583, 0.03, "34 % измерено — 36,5 % на стекле");
        // Низ: растяжение уходит к 20 %, а ниже показанное равно измеренному — туда смотрят
        // сообщения 15 / 10 / 5 % и блокировка.
        bool eq_low = true; mono = true; int below = 0;
        for (int i = 0; i < 17 * 288; i++) {
            t += 300;
            const float m = 34.0f - 2.0f * (i + 1) / 288.0f;
            if (m < 0.0f) break;
            r = step(st, m, false, false, 0.0f, t, k, have_k);
            if (r.shown > prev + 1e-5f) mono = false;
            prev = r.shown;
            // Ниже LOW_PCT сглаживания нет, но накопленное выше отставание (0,358) надо ещё
            // догнать, и темп там 2 пункта в час — на это уходит около 11 минут. Проверяются
            // поэтому все записи, кроме первых четырёх после перехода: иначе проверка ловила бы
            // переход, а не правило.
            if (m < LOW_PCT && ++below > 4 && fabsf(r.shown - m) > 0.01f) eq_low = false;
        }
        ok(mono, "и через полосу, где растяжение уходит, тоже только падает");
        ok(eq_low, "ниже 20 % на стекле ровно измеренное");
        ok(below > 4, "(и записи ниже 20 % в прогоне действительно были)");
        ok(r.shown < 0.05f, "и к порогу отключения — ноль: 0 % на стекле значит «сейчас отключится»");
    }

    area("батарея: показанный процент — кабель вынут раньше времени");
    {
        using namespace BatteryDisplay;
        State st; reset(st);
        double t = 1759000000.0;
        step(st, 100.0f, true, false, 80.0f, t, 1.0f, true);           // оценка заряда щедрая: 80
        t += 300;
        Step r = step(st, 60.0f, false, false, 0.0f, t, 1.0f, true);   // а в ячейке 60
        near(r.shown, 80.0, 1e-4, "в момент отключения на стекле те же 80 — не 60");
        float prev = r.shown; bool mono = true, above = true;
        float at24 = 0.0f, at42 = 0.0f;
        for (int i = 1; i <= 48 * 12; i++) {                          // двое суток по 5 мин
            t += 300;
            const float m = 60.0f - 0.5f * i / 288.0f;                // и обычный расход 0,5 %/сут
            r = step(st, m, false, false, 0.0f, t, 1.0f, true);
            if (r.shown > prev + 1e-5f) mono = false;
            if (r.shown < m - 1e-4f) above = false;
            prev = r.shown;
            if (i == 24 * 12) at24 = r.shown - m;
            if (i == 42 * 12) at42 = r.shown - m;
        }
        ok(mono, "процент только падает");
        ok(above, "и никогда не ниже измеренного");
        // Темп — это теперь скорость ПОКАЗАННОГО (0,5 пункта в час), а не скорость закрытия
        // разрыва: за сутки стекло проходит 12 пунктов, а измерение за это время уходит на 0,5
        // своим расходом, так что разрыв 20 -> 8,5. Разница с прежним правилом — 1,7 ч на спуск
        // в двое суток, и это цена того, что ограничитель симметричен и шум его не двигает.
        near(at24, 20.0 - 12.0 + 0.5, 0.05, "за сутки разрыв 20 -> 8,5: 0,5 пункта в час на стекле");
        // Не ровно ноль: цель сглажена (SMOOTH_TAU_S), и фильтр отстаёт от настоящего измерения на
        // tau × скорость разряда — 4 ч × 0,5 %/сут = 0,084 пункта. Это десятая доля деления шкалы,
        // которую владелец видит, и цена за то, что шум измерения стекло не двигает вовсе.
        near(at42, 0.084, 0.02, "к 42 часам разрыв закрыт — с точностью до отставания фильтра");
    }

    area("батарея: показанный процент — шум, низ, обучение, мусор");
    {
        using namespace BatteryDisplay;
        // ШУМ НЕ СДВИГАЕТ ЧИСЛО НИ В ОДНУ СТОРОНУ — и это главная проверка правки 2026-10-19.
        // Измерение пляшет ±0,5 вокруг медленного спуска 500 шагов (41,7 ч). Прежняя защёлка
        // кончила бы у НИЖНЕЙ кромки этой пляски и ниже: она принимала только наименьшее, что цель
        // когда-либо показывала, а каждый шаг вдобавок вычитал темп. Ограничитель симметричен,
        // поэтому стекло садится на СРЕДНЮЮ линию, а не на дно.
        State st; reset(st);
        double t = 1759000000.0;
        float worst = 0.0f; Step r{};
        for (int i = 0; i < 500; i++) {
            t += 300;
            const float m = 70.0f - 0.002f * i + ((i & 1) ? 0.5f : -0.5f);
            const float was = i ? r.shown : 70.0f;
            r = step(st, m, false, false, 0.0f, t, 1.0f, true);
            const float moved = fabsf(r.shown - was);
            if (i && moved > worst) worst = moved;
        }
        // 69,002 — средняя линия в конце; стекло отстаёт от неё на tau × скорость спада
        // (4 ч × 0,024 пункта/ч = 0,1), то есть стоит НА НЕЙ, а не на дне пляски.
        const float mean_end = 70.0f - 0.002f * 499.0f;
        near(r.shown, mean_end + 0.1f, 0.1, "стекло стоит на средней линии, а не на дне пляски");
        // И не замерло: за эти 41,7 ч средняя линия ушла на пункт, и стекло ушло с ней. ЭТО и
        // ловит первую редакцию правки — чистый ограничитель скорости без сглаживания цели здесь
        // ходил вверх-вниз на шаг и не сдвинулся ни на сотую.
        ok(r.shown < 69.6f, "и за 41,7 ч оно прошло этот пункт вниз вместе с ней");
        ok(worst <= CATCHUP_PCT_H * 300.0f / 3600.0f + 1e-4f,
           "и ни один шаг не больше темпа владельца");

        // Разрыв у дна закрывается вчетверо быстрее: 2 пункта в час.
        reset(st); t = 1759000000.0;
        step(st, 30.0f, true, false, 25.0f, t, 1.0f, true);
        t += 300; step(st, 15.0f, false, false, 0.0f, t, 1.0f, true);
        for (int i = 0; i < 12; i++) { t += 300; r = step(st, 15.0f, false, false, 0.0f, t, 1.0f, true); }
        near(r.shown, 25.0 - 2.0, 0.01, "ниже 20 % разрыв уходит со скоростью 2 пункта в час");

        // Обучение. Второй полный заряд двигает масштаб наполовину; неправдоподобный «полный» не учится.
        auto full_charge = [](float settled, float k, bool have_k) {
            State s; reset(s);
            double tt = 1759000000.0;
            step(s, 100.0f, true, true, 100.0f, tt, k, have_k);
            Step o{};
            for (int i = 0; i <= 49; i++) { tt += 300; o = step(s, settled, false, false, 0.0f, tt, k, have_k);
                                             if (o.learned) break; }
            return o;
        };
        Step a = full_charge(97.0f, 100.0f / 94.0f, true);
        ok(a.learned, "второй полный заряд учится");
        near(a.k, 0.5 * (100.0 / 94.0 + 100.0 / 97.0), 0.0005, "и масштаб сдвигается наполовину к новому");
        a = full_charge(75.0f, 1.0f, false);
        ok(!a.learned && fabsf(a.k - 1.0f) < 1e-6f, "«полный» на 75 % не учится — это не полная ячейка");
        a = full_charge(81.0f, 1.0f, false);
        ok(a.learned && a.k <= K_MAX, "81 % ещё учится, масштаб в пределах");

        // Кабель вернули, пока ячейка успокаивалась: учиться не на чем.
        reset(st); t = 1759000000.0;
        step(st, 100.0f, true, true, 100.0f, t, 1.0f, false);
        t += 300; step(st, 95.0f, false, false, 0.0f, t, 1.0f, false);
        t += 3600; step(st, 99.0f, true, false, 99.0f, t, 1.0f, false);
        bool any = false;
        for (int i = 0; i < 60; i++) { t += 300; any |= step(st, 95.0f, false, false, 0.0f, t, 1.0f, false).learned; }
        ok(!any, "кабель вернули до конца отстоя — обучение отменено");

        // Мусор в RTC после смены образа: первое же показание — честное измерение, без NaN.
        memset(&st, 0xFF, sizeof(st));
        r = step(st, 55.0f, false, false, 0.0f, 1759000000.0, 1.0f, true);
        near(r.shown, 55.0, 1e-4, "из мусора — показание по измерению");
        // Мусор в хранилище масштаба — как будто его нет.
        reset(st);
        r = step(st, 55.0f, false, false, 0.0f, 1759000000.0, NAN, true);
        near(r.shown, 55.0, 1e-4, "масштаб NaN считается отсутствующим");

        // Часы перевели (первая синхронизация): годы между двумя замерами — не время на батарее.
        reset(st); t = 1000.0;
        step(st, 100.0f, true, false, 80.0f, t, 1.0f, true);
        t += 300; step(st, 60.0f, false, false, 0.0f, t, 1.0f, true);
        r = step(st, 60.0f, false, false, 0.0f, 1759000000.0, 1.0f, true);
        near(r.shown, 80.0, 1e-4, "скачок часов на годы разрыв не съедает");
    }

    area("батарея: показанный процент на плате v2 целиком");
    {
        // Весь путь BatteryMonitor на делителе: зарядник сказал «готово», ячейка встаёт ниже верха
        // таблицы, прибор выучивает масштаб в NVS — и подключение кабеля не отнимает пункт.
        fresh(); auto bus = v2_bus();
        BatteryInfo bi;
        double t = 1759000000.0;
        Host::vcell = 3.90f;
        BatteryMonitor::getInstance().update(bus, t, bi, false);
        Host::usb_in = true; Host::vcell = 4.19f; Host::stdby_low = true;
        t += 300; BatteryMonitor::getInstance().update(bus, t, bi, true);
        near(bi.soc, 100.0, 1e-3, "зарядник закончил — 100");
        Host::usb_in = false; Host::stdby_low = false; Host::vcell = 4.04f;
        const float m_full = BatterySource::socFromVoltage(4.04f);
        ok(m_full < 99.0f, "(ячейка встаёт ниже верха таблицы — иначе проверка ничего не доказывает)");
        bool held = true;
        for (int i = 0; i < 50; i++) {
            t += 300; BatteryMonitor::getInstance().update(bus, t, bi, false);
            if (fabsf(bi.soc - 100.0f) > 0.05f) held = false;
        }
        ok(held, "после отключения 100 и через 4 ч — 100: прибор выучил полную ячейку");
        float k = 0.0f;
        ok(NVSManager::getInstance().getFloat("bat_fullk", k, 0.0f), "масштаб сохранён в NVS");
        // Делитель читает 4,04 В с шагом кода АЦП, поэтому сверка — с тем, что прибор измерил.
        near(bi.soc_raw, m_full, 0.5, "в историю идёт измеренное");
        near(k, 100.0 / bi.soc_raw, 0.002, "масштаб = 100 / измеренное");
        // Разряд до середины, потом кабель на той же ячейке: показанное выше измеренного, и
        // подключение его не роняет.
        Host::vcell = 3.95f;
        for (int i = 0; i < 300; i++) { t += 300; BatteryMonitor::getInstance().update(bus, t, bi, false); }
        const float shown_bat = bi.soc;
        ok(shown_bat > bi.soc_raw + 0.5f, "(на батарее показанное выше измеренного — иначе проверка ничего не доказывает)");
        Host::usb_in = true;
        t += 300; BatteryMonitor::getInstance().update(bus, t, bi, true);
        ok(bi.soc >= shown_bat - 1e-3f, "кабель вставлен — на стекле не меньше, чем было");
        Host::usb_in = false;
    }

    area("стенд АКБ: замеры R7 покрывают заряд");
    {
        // Ровно ряд C0 платы f708 (2026-10-03): владелец ушёл из дома между 0:10 и 1:24. Прямая
        // через этот час дала бы 0,56 А·ч, а правда — где угодно до 0,8: там постоянный ток
        // переходит в падающий. Прежнее правило смотрело только на начало и конец и такой ряд
        // принимало; на C1 ошибка ушла бы в измеренный ток нагрузки и в сравнение двух ячеек.
        CurveSummary::Charge c;
        c.done = true; c.t_done = 5520;
        const CurveSummary::Charge::Prog f708[] = {{159, 0.59f}, {647, 0.57f}, {5040, 0.15f}, {5400, 0.11f}};
        for (const auto &p : f708) c.prog[c.prog_n++] = p;
        c.integrate();
        eq_int(c.prog_gap(), 5040 - 647, "самая длинная дыра — 1:13 между вторым и третьим замером");
        ok(!c.prog_covers(), "ряд с часовой дырой не считается покрывающим заряд");
        // Граница в обе стороны: замеры по расписанию, одна дыра ровно 30 мин — пропущен один замер.
        auto sched = [](uint32_t big_gap, uint32_t tail) {
            CurveSummary::Charge k;
            const uint32_t ts[] = {120, 600, 1200, 1800, 2700};
            for (uint32_t t : ts) k.prog[k.prog_n++] = {t, 0.95f};
            k.prog[k.prog_n++] = {2700 + big_gap, 0.40f};
            k.done = true; k.t_done = 2700 + big_gap + tail;
            k.integrate();
            return k;
        };
        ok(sched(1800, 600).prog_covers(), "дыра ровно 30 мин (один пропущенный замер) — ещё измерение");
        ok(!sched(1801, 600).prog_covers(), "на секунду больше — уже нет");
        ok(sched(900, 1800).prog_covers(), "от последнего замера до конца заряда 30 мин — ещё да");
        ok(!sched(900, 1801).prog_covers(), "больше — нет: конец заряда тоже дыра");
    }

    area("батарея: расход по истории");
    {
        using namespace PowerEstimate;
        // Запись истории раз в 15 мин. Разряд 0,5 %/сут и 10 мВ/сут — середина того, что делает
        // прибор; числа ниже посчитаны от них вручную, а не сняты с самого кода.
        //
        // hours и drop описывают ОКНО ФИТА, и с 2026-10-19 это ВЕСЬ отрезок после отсечки кабеля,
        // а не его хвостовая половина: половина была там, чтобы не захватить отход от зарядника, а
        // это делает SETTLE_S, по времени. На медленной ячейке половина десяти суток — пять, а пять
        // суток при 0,65 %/сут это 3,3 % против 6 % точности газомера, то есть окно было короче
        // того, что им мерили. drop по-прежнему наклон × окно, а не разность концов (2026-10-13).
        //
        // Фильтра «скачков» здесь больше нет — вместо него симметричный отсев по 3σ. Почему это
        // исправление, а не упрощение, написано в fit(); блок «СКАЧКОВ БОЛЬШЕ НЕТ ПО ПОСТРОЕНИЮ»
        // ниже называет цену и место, где посылка охраняется.
        auto run = [](std::vector<Point> &v, uint32_t t0, int n, float soc0, float v0,
                      float pct_day, float mv_day, bool usb = false) {
            for (int i = 0; i < n; i++) {
                const float h = i * 0.25f;
                v.push_back({ t0 + (uint32_t)(i * 900), soc0 - pct_day * h / 24.0f,
                              v0 - mv_day / 1000.0f * h / 24.0f, usb });
            }
        };
        const uint32_t T0 = 1759000000;
        {
            // Ровно случай с телефона: двенадцать часов на батарее, заряд сдвинулся на четверть
            // процента. Направление видно, число — нет.
            std::vector<Point> v; run(v, T0, 49, 83.0f, 4.00f, 0.5f, 10.0f);
            const Result r = fit(v.data(), (int)v.size(), 2000);
            ok(r.valid, "12 ч на батарее: подгонка есть");
            eq_int(r.conf, 0, "но падение меньше процента — «рано»");
            const Card c = card(r, 82.75f, false);
            ok(c.pct_day == 0.0f && c.mah_day == 0.0f && c.tte_h < 0.0f,
               "и карточка числа придерживает: ни %/сут, ни мА·ч, ни дней");
        }
        {
            // 192 ч ровно: окно фита — весь отрезок, падение 0,5 %/сут × 192 ч = 4 %.
            std::vector<Point> v; run(v, T0, 769, 83.0f, 4.00f, 0.5f, 10.0f);   // 192 ч
            const Result r = fit(v.data(), (int)v.size(), 2000);
            ok(r.valid, "192 ч: подгонка есть");
            near(r.hours, 192.0, 0.01, "окно фита — весь отрезок, а не половина");
            near(r.drop, 4.0, 0.01, "и падение в нём 0,5 %/сут × 192 ч = 4 %");
            eq_int(r.conf, 2, "падение 4 % — «можно верить»");
            eq_int(r.dropped, 0, "чистая прямая — ни одной точки не отсеяно");
            near(r.pct_day, 0.5, 0.005, "наклон 0,5 %/сут");
            near(r.ua, 416.7, 1.0, "ток = 0,5 %/сут × 2000 мА·ч = 416,7 мкА");
            near(r.months, 6.570, 0.02, "полная ячейка: 2000 мА·ч / 0,4167 мА = 6,57 мес");
            // ОДНА скидка, не две (2026-10-19). Ноль процентов на обеих таблицах ячеек — это уже
            // порог отключения, а стенд намерял 1,99 А·ч до 3,30 В на ячейке 2000 мА·ч: паспорт
            // ЕСТЬ ёмкость до порога. Второе умножение на 0,85 делало «на полной» на 15 % короче,
            // чем 100 % / (%/сут), напечатанное рядом, — то есть обещало смерть прибора на 15 %.
            near(r.months * 30.44, 100.0 / r.pct_day, 0.5,
               "«на полной» сходится с 100 % / (%/сут) рядом — одна скидка, не две");
            const Card c = card(r, 81.0f, false);
            near(c.pct_day, 0.5, 0.005, "карточка: тот же наклон");
            near(c.mah_day, 10.0, 0.05, "карточка: 10 мА·ч в сутки");
            near(c.tte_h, 3888.0, 8.0, "карточка: 81 % / 0,5 %/сут = 162 сут");
            const Card u = card(r, 81.0f, true);
            ok(u.tte_h < 0.0f, "на кабеле времени до разряда нет — ничего не разряжается");
            near(u.pct_day, 0.5, 0.005, "а расход прошлого отрезка остаётся измерением");
        }
        {
            // Только что с зарядника: ячейка отходит, и проценты по её вольтам падают почти без отдачи.
            // Первые SETTLE_S после кабеля не считаются, иначе падение выглядело бы как 14 % и «можно
            // верить». До 2026-10-08 отсечка была по напряжению (4,05 В) — на 103450 это 87 %, и она
            // выбрасывала первые восемь суток каждого заряда.
            std::vector<Point> v; run(v, T0, 8, 70.0f, 4.20f, -40.0f, 0.0f, true);   // кабель
            run(v, T0 + 8 * 900, 10, 100.0f, 4.15f, 48.0f, 960.0f);                  // отход, 2,5 ч
            run(v, T0 + 18 * 900, 385, 83.0f, 4.00f, 0.5f, 10.0f);                   // устоявшаяся
            const Result r = fit(v.data(), (int)v.size(), 2000);
            // Отрезок после отсечки — 86,5 ч (2,5 ч отхода и 38 точек устоявшейся части выброшены),
            // падение в нём 0,5 %/сут × 86,5 ч = 1,80 %.
            near(r.hours, 86.5, 0.01, "окно фита — устоявшаяся часть целиком");
            near(r.drop, 0.5 * 86.5 / 24.0, 0.01, "первые 12 ч после кабеля выброшены");
            near(r.pct_day, 0.5, 0.005, "и наклон её же");
            eq_int(r.conf, 1, "уверенность не раздута отходом: 1,80 %, а не 14 — то есть «грубо»");
            std::vector<Point> w; run(w, T0, 8, 70.0f, 4.20f, -40.0f, 0.0f, true);
            run(w, T0 + 8 * 900, 40, 99.0f, 4.12f, 2.0f, 10.0f);                     // 10 ч
            ok(!fit(w.data(), (int)w.size(), 2000).valid, "весь отрезок ещё отходит от зарядника — оценки нет");
            // А отрезок, начавшийся вместе с данными, не отходит от кабеля, которого мы не видели:
            // ничего не выбрасывается.
            std::vector<Point> u; run(u, T0, 385, 83.0f, 4.00f, 0.5f, 10.0f);
            near(fit(u.data(), (int)u.size(), 2000).hours, 96.0, 0.01,
                 "отрезок без кабеля перед ним — ничего не выброшено: окно все его 96 ч");
        }
        {
            // Плато: проценты идут, вольты почти нет. До 2026-10-08 это отвергалось как «газомер
            // переставил модель» — правилом «процент упал, а 12 мВ нет», написанным для кривой, где
            // процент это 8-14 мВ. На 103450 процент — 1,4-2,8 мВ, и полевая плата неделю сидела на
            // «collecting», пока честно разряжалась. Перестройка модели — СКАЧОК; плато — наклон.
            std::vector<Point> v; run(v, T0, 385, 83.0f, 4.00f, 0.5f, 1.0f);
            const Result r = fit(v.data(), (int)v.size(), 2000);
            ok(r.valid, "падение без потери вольт — это расход на плато, и он показан");
            near(r.pct_day, 0.5, 0.005, "с тем же наклоном");
            eq_int(r.dropped, 0, "и ни одной точки в нём не отсеяно");
            ok(r.mv < 12.0f, "(вольт ушло меньше 12 мВ — ровно то, что прежнее правило отвергало)");
        }
        {
            // Полевая плата 2026-10-01..08 как есть: 4,055 → 4,044 В за семь суток, процент — по таблице
            // её ячейки. Числа таблицы — из журнала стенда f708, не с этого кода.
            std::vector<Point> v;
            for (int i = 0; i <= 7 * 96; i++) {
                const float volts = 4.055f - 0.011f * i / (7.0f * 96.0f);
                v.push_back({ T0 + (uint32_t)(i * 900),
                              BatterySource::socFromVoltage(volts, BatterySource::Cell103450), volts, false });
            }
            const Result r = fit(v.data(), (int)v.size(), 2000);
            // ЭТО И ЕСТЬ ТО, ЧЕГО ЖДАЛ ВЛАДЕЛЕЦ. До 2026-10-19 фит брал хвостовую половину, то
            // есть 84 ч, падение в них выходило 2,56 % — ниже GOOD_DROP_PCT, — и неделя честного
            // разряда доходила до страницы как «rough»; на полевой плате это тянулось месяц.
            // Теперь окно — все 168 ч, и падения в них 4,27 % хватает.
            ok(r.valid && r.conf == 2, "неделя на плато 103450 — оценка есть, и ей можно верить");
            // Окно — 168 ч, 4,055 → 4,044 В, то есть 88,214 → 83,571 % по таблице. Наклон по
            // наименьшим квадратам в ОДИН проход 0,6104 %/сут; в два, с отсевом по 3σ, — 0,6008 и
            // падение 0,6008 × 168/24 = 4,206 %. Оба числа посчитаны отдельно, на таблице из
            // журнала стенда f708, а не сняты с этого кода.
            //
            // Отсев здесь снимает 16 точек из 673 — и это не шум, его в этом ряду нет вовсе:
            // таблица кусочно-линейна, остатки у её изломов систематические, и 3σ режет структуру.
            // Цена — 1,6 % наклона, то есть меньше всякой другой погрешности здесь; а снимать отсев
            // ради неё значило бы вернуть одиночным выбросам право двигать число.
            near(r.drop, 4.206, 0.02, "падение окна — 4,21 % по таблице");
            eq_int(r.dropped, 16, "и 16 точек у изломов таблицы отсеяны как выбросы");
            near(r.pct_day, 0.6008, 0.005, "наклон 0,60 %/сут, а не 0,15, которые показывала модель газомера");
            // И цифра совпала с полем: на СВОИХ десяти сутках (241 запись из Home Assistant) этот
            // же код даёт 0,680 %/сут = 555 мкА, против 0,65-0,71 по вольтам, по бюджету журнала
            // событий и по кривой ячейки. Прежний фильтр на тех же данных отвечал 2,05 %/сут.
        }
        {
            // СКАЧКОВ БОЛЬШЕ НЕТ ПО ПОСТРОЕНИЮ, и здесь записана цена этой посылки.
            //
            // Ступенька уровня — не выброс: половина точек ложится выше прямой, половина ниже, и
            // отсев по 3σ её не видит. Она наклоняет фит: минус 5 % посередине 96-часового окна
            // стоят 1,5 × 5 / 96 ч = 1,875 %/сут, то есть вместо 0,5 выходит 2,37 (посчитано
            // отдельно по cov(x, ступень)/var(x), а не снято с кода). Прежний фильтр это и
            // вынимал — ценой того, что вместе со ступеньками он вынимал шум ПЛАТО В ОДНУ СТОРОНУ
            // и делал из него дрейф: на полевых данных 2,05 %/сут против истинных 0,68.
            //
            // Обмен сделан потому, что ИСТОЧНИКИ ступенек убраны, все три:
            //   * удержание «на батарее процент не растёт» жило в RTC_DATA и начиналось заново на
            //     каждом esp_restart — снято из percent() 2026-10-14, и что его там нет, проверяет
            //     t_console.py («rtc_soc_hold» не встречается в battery_source.cpp);
            //   * модель SOC газомера на v1 больше не читается — процент считается по кривой ячейки
            //     с 0.10.37, то есть переставить её нечему;
            //   * смена способа счёта режет отрезок сама — HIST_FLAG_CURVE, блок ниже.
            // Появится четвёртый — чинить надо будет его, а не прятать здесь.
            std::vector<Point> v; run(v, T0, 193, 83.0f, 4.00f, 0.5f, 10.0f);
            run(v, T0 + 193 * 900, 192, 83.0f - 0.5f * 48.25f / 24.0f - 5.0f, 3.99f, 0.5f, 10.0f);
            const Result r = fit(v.data(), (int)v.size(), 2000);
            near(r.pct_day, 2.370, 0.02, "ступень вниз НАКЛОНЯЕТ фит — 2,37 %/сут вместо 0,5");
            eq_int(r.dropped, 0, "и отсевом по сигме она не ловится: это уровень, а не выброс");
            // А ступень ВВЕРХ перевешивает настоящий наклон (1,5 % посередине = 0,56 %/сут вверх
            // против 0,5 вниз), и тогда оценка отказывает, а не врёт: заряд на батарее не прибывает.
            std::vector<Point> u; run(u, T0, 193, 83.0f, 4.00f, 0.5f, 10.0f);
            run(u, T0 + 193 * 900, 192, 83.0f - 0.5f * 48.25f / 24.0f + 1.5f, 3.99f, 0.5f, 10.0f);
            ok(!fit(u.data(), (int)u.size(), 2000).valid,
               "ступень вверх перевешивает наклон — оценки нет, а не отрицательный расход");
        }
        {
            // Шум НЕ вынимается — и теперь это не правило, а свойство: наименьшие квадраты для того
            // и существуют, чтобы симметричный шум усреднять. Дрожание ±0,2 % это ровно 1σ, то есть
            // до порога отсева ему втрое.
            std::vector<Point> v; run(v, T0, 385, 83.0f, 4.00f, 0.5f, 10.0f);
            for (size_t i = 0; i < v.size(); i++) v[i].soc += (i % 2) ? 0.2f : -0.2f;
            const Result r = fit(v.data(), (int)v.size(), 2000);
            eq_int(r.dropped, 0, "дрожание ±0,2 % целиком остаётся в ряду");
            near(r.pct_day, 0.5, 0.02, "и наклон им не раздут");
        }
        {
            // Сессия консоли — настоящий расход: 40 минут радио, ~3 % заряда, и записей в это время
            // нет. Это быстрее обычного, но не быстрее, чем прибор вообще умеет тратить.
            // Отличить такую трату от «скачка» нечем, и это второй довод за снятый фильтр: прежнее
            // правило держалось на том, что прибор не умеет тратить быстрее 6 %/ч, то есть на одном
            // шаге от того, чтобы съесть настоящую сессию.
            std::vector<Point> v; run(v, T0, 289, 83.0f, 4.00f, 0.5f, 10.0f);   // 72 ч
            const float at = 83.0f - 0.5f * 72.0f / 24.0f;
            run(v, T0 + 288 * 900 + 3300, 97, at - 3.0f, 3.99f, 0.5f, 10.0f);
            const Result r = fit(v.data(), (int)v.size(), 2000);
            eq_int(r.dropped, 0, "три процента за 55 минут — не выброс, а работа");
            near(r.drop, 5.392, 0.02, "и они в падении: 5,39 % на окне 96,9 ч (вычти их — осталось бы 2)");
        }
        {
            // Хвост на кабеле не портит оценку, а старый отрезок до кабеля в неё не входит.
            std::vector<Point> v; run(v, T0, 193, 90.0f, 4.04f, 5.0f, 60.0f);          // 48 ч, 5 %/сут
            run(v, T0 + 193 * 900, 8, 80.0f, 4.20f, -40.0f, 0.0f, true);              // заряд
            run(v, T0 + 201 * 900, 385, 83.0f, 4.00f, 0.5f, 10.0f);                   // новый отрезок
            run(v, T0 + 586 * 900, 6, 81.0f, 4.20f, -40.0f, 0.0f, true);              // снова кабель
            const Result r = fit(v.data(), (int)v.size(), 2000);
            near(r.pct_day, 0.5, 0.005, "считается только последний отрезок на батарее");
            // Отрезок начался у кабеля, поэтому его первые 12 ч (SETTLE_S) не в счёт: 84 ч из 96.
            // С захваченным старым разрядом падение вышло бы 9 % вместо 1,75 — и «можно верить».
            near(r.drop, 0.5 * 84.0 / 24.0, 0.02, "падение тоже только этого отрезка");
            near(r.hours, 84.0, 0.01, "и срок, на котором стоит оценка — его 84 ч");
            eq_int(r.conf, 1, "уверенность не раздута чужим разрядом: 1,75 %, а не 9");
        }
        {
            // САМ ДЕФЕКТ 2026-10-13: прямая через постоянную плоская — но не ровно, наименьшие
            // квадраты отдают 1e-13 %/сут, «наклон больше нуля» это пропускает, и деление
            // поставило в Home Assistant 2 147 483 647 дней. Останавливает его MIN_FIT_PCT.
            std::vector<Point> f; run(f, T0, 541, 80.0f, 4.04f, 0.0f, 0.0f);     // 135 ч ровно
            const Result rf = fit(f.data(), (int)f.size(), 2000);
            ok(!rf.valid, "окно стоит на одном значении — числа нет");
            const Card cf = card(rf, 79.0f, false);
            ok(cf.tte_h < 0.0f && cf.pct_day == 0.0f, "и карточка молчит, а не показывает 2^31 дней");
            // А ряд, который СПАДАЛ, а потом встал, теперь даёт число — и это тоже часть правки
            // 2026-10-19. Ячейка за эти 135 ч отдала 2,5 %, то есть 0,417 %/сут в среднем по окну
            // (посчитано отдельно), и назвать их честнее, чем молчать: при хвостовой половине окна
            // фит смотрел только на вставшую часть, и полевая плата сидела на «collecting».
            std::vector<Point> v; run(v, T0, 241, 80.0f, 4.04f, 1.0f, 2.0f);     // 60 ч спада
            const float flat = v.back().soc, flatv = v.back().v;
            const uint32_t t_flat = v.back().t;
            for (int i = 1; i <= 300; i++) v.push_back({ t_flat + (uint32_t)(i * 900), flat, flatv, false });
            const Result r = fit(v.data(), (int)v.size(), 2000);
            ok(r.valid, "спад, а потом плато — число есть");
            near(r.pct_day, 0.417, 0.01, "и это средний наклон по всему окну, 0,42 %/сут");
        }
        {
            // Пол отделяет «медленно» от «не двигалось вовсе», и ни в одном режиме прибора таких
            // чисел нет: 0,015 %/сут — это 18 лет на ячейку. Окно 135 ч, падение в нём
            // 0,015 × 135/24 = 0,084 % — ниже MIN_FIT_PCT.
            std::vector<Point> v; run(v, T0, 541, 80.0f, 4.04f, 0.015f, 0.0f);
            ok(!fit(v.data(), (int)v.size(), 2000).valid, "окно не двинулось — оценки нет");
        }
        {
            // А 0,1 %/сут — это Ultra Save, и такое число есть: 0,1 × 135/24 = 0,56 % в окне.
            // Подгонка состоялась, но три факта карточки ждут процента (conf >= 1) — именно это и
            // держит их в границах: сто процентов, делённые на «не меньше процента за окно», дают
            // не больше ста окон, то есть около 500 суток, и больше карточка сказать не может.
            std::vector<Point> v; run(v, T0, 541, 80.0f, 4.04f, 0.1f, 0.0f);
            const Result r = fit(v.data(), (int)v.size(), 2000);
            ok(r.valid, "0,1 %/сут — оценка есть");
            eq_int(r.conf, 0, "но это «рано»: падение в окне 0,56 %");
            const Card c = card(r, 79.0f, false);
            ok(c.tte_h < 0.0f, "и карточка дней не называет");
        }
        {
            // Одиночный выброс — не уровень. Запись, попавшая в радиоокно или в полчаса, которые
            // среднему нужно от него отойти, читается на плато на проценты мимо. ЭТО и отсевается —
            // симметрично, по расстоянию от прямой: 4 % на 769 записях это много сигм. Сам по себе
            // он наклон почти не двигает (0,002 %/сут, посчитано отдельно), поэтому проверка смотрит
            // и на то, что он назван выбросом, и на то, что ряд от него не поехал.
            std::vector<Point> v; run(v, T0, 769, 83.0f, 4.00f, 0.5f, 10.0f);
            const Result clean = fit(v.data(), (int)v.size(), 2000);
            eq_int(clean.dropped, 0, "на чистой прямой отсеивать нечего");
            v[600].soc += 4.0f;                                  // одна запись, внутри окна фита
            const Result r = fit(v.data(), (int)v.size(), 2000);
            eq_int(r.dropped, 1, "выброс в одну запись отсеян — и ровно он один");
            near(r.pct_day, clean.pct_day, 0.005, "и наклон от него не шевельнулся");
            v[600].soc -= 8.0f;                                  // и в другую сторону
            const Result d = fit(v.data(), (int)v.size(), 2000);
            eq_int(d.dropped, 1, "вниз — так же");
            near(d.pct_day, clean.pct_day, 0.005, "ни вверх, ни вниз");
        }
        {
            std::vector<Point> v; run(v, T0, 385, 60.0f, 3.80f, -0.5f, -10.0f);
            ok(!fit(v.data(), (int)v.size(), 2000).valid, "растущий заряд — не расход");
        }
    }

    // ---------------------------------------------------------------------------------------------
    // Та же оценка, но через НАСТОЯЩЕЕ кольцо истории: её спрашивают и страница, и MQTT (то есть
    // Home Assistant), и разойтись они не должны. До 2026-10-04 HA считал своё — производную целых
    // процентов — и показывал «0,174 мА, 392 дня» прибору, тратившему около 0,43.
    area("батарея: одна оценка для страницы и для хаба");
    {
        using namespace PowerEstimate;
        fresh();
        HistStore::getInstance().init();
        HistStore::getInstance().eraseAll();
        ok(std::string(PowerHistory::quality(PowerHistory::estimate())) == "collecting",
           "пустая история — «collecting», а не число");
        const uint32_t T0 = 1759000000;
        auto put = [](uint32_t t, float soc, float v, bool usb) {
            HistRec r{}; r.t = t; r.soc = (uint8_t)(soc + 0.5f); r.soc_d = (uint16_t)(soc * 100 + 0.5f);
            r.vcell_mv = (uint16_t)(v * 1000 + 0.5f); r.flags = usb ? 0x20 : 0;
            HistStore::getInstance().append(r);
        };
        // Записи старого формата (без напряжения) — не угадываются, а пропускаются.
        for (int i = 0; i < 10; i++) { HistRec r{}; r.t = T0 - 3600 + i * 60; r.soc = 99; HistStore::getInstance().append(r); }
        std::vector<Point> same;
        for (int i = 0; i < 769; i++) {                       // 192 ч по 15 мин: 0,5 %/сут, 10 мВ/сут
            const float h = i * 0.25f;
            const float soc = 83.0f - 0.5f * h / 24.0f, v = 4.00f - 0.010f * h / 24.0f;
            put(T0 + i * 900, soc, v, false);
            same.push_back({T0 + (uint32_t)(i * 900), (uint16_t)(soc * 100 + 0.5f) / 100.0f,
                            (uint16_t)(v * 1000 + 0.5f) / 1000.0f, false});
        }
        const Result h = PowerHistory::estimate();
        const Result f = fit(same.data(), (int)same.size(), BATTERY_CAPACITY_MAH);
        ok(h.valid && f.valid, "по истории оценка есть");
        near(h.pct_day, f.pct_day, 1e-4, "кольцо даёт ту же подгонку, что и точки напрямую");
        near(h.pct_day, 0.5, 0.01, "и это 0,5 %/сут");
        ok(std::string(PowerHistory::quality(h)) == "good", "падение 4 % в окне фита — «good»");
        // Кабель в конце: оценка последнего отрезка остаётся, а время до разряда — нет.
        for (int i = 0; i < 4; i++) put(T0 + (769 + i) * 900, 79.0f + i, 4.15f, true);
        const Result u = PowerHistory::estimate();
        near(u.pct_day, 0.5, 0.01, "хвост на кабеле не портит оценку прошлого отрезка");
        ok(card(u, 84.0f, true).tte_h < 0.0f, "а «дней осталось» на кабеле не говорится");

        // Окно — время, а не число записей (2026-10-08): 600 записей были шестью сутками при шаге
        // 15 мин и двумя при 5, а на медленной ячейке за двое суток не видно ничего. Десять суток от
        // ПОСЛЕДНЕЙ записи — не от часов: оценка описывает то, что лежит в истории.
        fresh();
        HistStore::getInstance().init();
        HistStore::getInstance().eraseAll();
        for (int i = 0; i < 20 * 24; i++)                         // 20 суток раз в час, 1 %/сут
            put(T0 + i * 3600, 95.0f - i / 24.0f, 4.00f - 0.002f * i / 24.0f, false);
        const Result w = PowerHistory::estimate();
        ok(w.valid, "двадцать суток на батарее — оценка есть");
        near(w.hours, PowerEstimate::WINDOW_S / 3600.0, 1.01,
             "но стоит она на последних десяти сутках, и целиком на них");
        near(w.pct_day, 1.0, 0.01, "и наклон тот же");

        // Прореживание не теряет кабель. Десять суток по 5 мин — 2880 записей, в работу идут не больше
        // 600; одна-единственная запись на кабеле в середине обязана разрезать отрезок, иначе подгонка
        // провела бы один наклон прямо через зарядку.
        fresh();
        HistStore::getInstance().init();
        HistStore::getInstance().eraseAll();
        for (int i = 0; i < 2880; i++) {
            const bool usb = (i == 2016);                          // седьмые сутки: на минуту воткнули
            const float d = i / 288.0f;                            // сутки
            put(T0 + i * 300, usb ? 99.0f : 95.0f - 0.8f * d, 4.00f - 0.002f * d, usb);
        }
        const Result c = PowerHistory::estimate();
        ok(c.valid, "оценка есть");
        // После кабеля трое суток без пяти минут, из них первые 12 ч — отход от зарядника. Допуск —
        // шаг прореживания к концу окна (каждая восьмая запись, 40 мин) на обоих концах отсечки.
        near(c.hours, (2879 - 2016) * 300 / 3600.0 - 12.0, 1.5,
             "отрезок начинается после той единственной записи на кабеле, а не десятью сутками раньше");
        near(c.pct_day, 0.8, 0.02, "и наклон его");

        // Тот же случай, но запись на кабеле — НЕЧЁТНАЯ, то есть сама в работу не попадает ни при
        // каком шаге прореживания: её признак обязан доехать до следующей оставленной точки. Номер
        // 2016 выше делится на шаг, оставался сам, и этот путь им не проверялся — слом «признак
        // пропущенной записи теряется» прошёл бы молча (так и было при первой проверке сломами).
        fresh();
        HistStore::getInstance().init();
        HistStore::getInstance().eraseAll();
        for (int i = 0; i < 2880; i++) {
            const bool usb = (i == 2017);
            const float d = i / 288.0f;
            put(T0 + i * 300, usb ? 99.0f : 95.0f - 0.8f * d, 4.00f - 0.002f * d, usb);
        }
        const Result c2 = PowerHistory::estimate();
        near(c2.hours, (2879 - 2017) * 300 / 3600.0 - 12.0, 1.5,
             "пропущенная прореживанием запись на кабеле всё равно режет отрезок");

        // Полевая плата v1 в день обновления 2026-10-08: десять суток записей, где процент давала
        // модель газомера (0,2 %/сут на плато), и дальше — по кривой ячейки (0,8 %/сут). Наклон через
        // оба прибора дал бы уверенное неверное число на пять суток. Оценка обязана взять только
        // новую часть — и без 12 ч отсечки: это не кабель, ячейка не отходит от зарядника.
        fresh();
        HistStore::getInstance().init();
        HistStore::getInstance().eraseAll();
        auto put_c = [](uint32_t t, float soc, float v, bool curve) {
            HistRec r{}; r.t = t; r.soc = (uint8_t)(soc + 0.5f); r.soc_d = (uint16_t)(soc * 100 + 0.5f);
            r.vcell_mv = (uint16_t)(v * 1000 + 0.5f); r.flags = curve ? HIST_FLAG_CURVE : 0;
            HistStore::getInstance().append(r);
        };
        for (int i = 0; i < 10 * 96; i++)
            put_c(T0 + i * 900, 85.0f - 0.2f * i / 96.0f, 4.05f - 0.001f * i / 96.0f, false);
        for (int i = 0; i < 3 * 96; i++)
            put_c(T0 + (960 + i) * 900, 83.0f - 0.8f * i / 96.0f, 4.04f - 0.0015f * i / 96.0f, true);
        const Result n = PowerHistory::estimate();
        ok(n.valid, "после смены способа счёта оценка есть");
        near(n.pct_day, 0.8, 0.01, "и это наклон новых записей, а не смесь с моделью газомера");
        // Новая часть — 287 шагов по 15 мин, то есть 71,75 ч. Отсечки кабеля здесь нет: ячейка
        // не отходит от зарядника, сменился только способ счёта.
        near(n.hours, 287 * 0.25, 0.01, "на одних новых записях — и без отсечки кабеля");
    }

    return report("цикл");
}
